SECTIONS
{
    __romPos = 0;
    _gp = 0x0;
    ST05_01C_PL00D06S_6_header_ROM_START = __romPos;
    ST05_01C_PL00D06S_6_header_VRAM = ADDR(.ST05_01C_PL00D06S_6_header);
    .ST05_01C_PL00D06S_6_header : AT(ST05_01C_PL00D06S_6_header_ROM_START) SUBALIGN(16)
    {
        ST05_01C_PL00D06S_6_header_DATA_START = .;
        ST05_01C_PL00D06S_6_header_s = .;
        build/asm/ST05_01C/ovl6__PLBIN_PL00D06S.PBD/ST05_01C_PL00D06S_6_header.s.o(.data);
        ST05_01C_PL00D06S_6_header_DATA_END = .;
        ST05_01C_PL00D06S_6_header_DATA_SIZE = ABSOLUTE(ST05_01C_PL00D06S_6_header_DATA_END - ST05_01C_PL00D06S_6_header_DATA_START);
    }
    __romPos += SIZEOF(.ST05_01C_PL00D06S_6_header);
    ST05_01C_PL00D06S_6_header_ROM_END = __romPos;
    ST05_01C_PL00D06S_6_header_VRAM_END = .;

    ST05_01C_PL00D06S_6_ROM_START = __romPos;
    ST05_01C_PL00D06S_6_VRAM = ADDR(.ST05_01C_PL00D06S_6);
    .ST05_01C_PL00D06S_6 0x800DBA00 : AT(ST05_01C_PL00D06S_6_ROM_START) SUBALIGN(4)
    {
        ST05_01C_PL00D06S_6_DATA_START = .;
        PL00D06S_6_data__s = .;
        build/asm/ST05_01C/ovl6__PLBIN_PL00D06S.PBD/data/PL00D06S_6.data.s.o(.data);
        ST05_01C_PL00D06S_6_DATA_END = .;
        ST05_01C_PL00D06S_6_DATA_SIZE = ABSOLUTE(ST05_01C_PL00D06S_6_DATA_END - ST05_01C_PL00D06S_6_DATA_START);
    }
    __romPos += SIZEOF(.ST05_01C_PL00D06S_6);
    __romPos = ALIGN(__romPos, 16);
    ST05_01C_PL00D06S_6_ROM_END = __romPos;
    ST05_01C_PL00D06S_6_VRAM_END = .;

    /DISCARD/ :
    {
        *(*);
    }
}
