SECTIONS
{
    __romPos = 0;
    _gp = 0x0;
    ARM09R_PL00R09M_2_header_ROM_START = __romPos;
    ARM09R_PL00R09M_2_header_VRAM = ADDR(.ARM09R_PL00R09M_2_header);
    .ARM09R_PL00R09M_2_header : AT(ARM09R_PL00R09M_2_header_ROM_START) SUBALIGN(16)
    {
        ARM09R_PL00R09M_2_header_DATA_START = .;
        ARM09R_PL00R09M_2_header_s = .;
        build/asm/ARM09R/ovl2__PLBIN_PL00R09M.PBD/ARM09R_PL00R09M_2_header.s.o(.data);
        ARM09R_PL00R09M_2_header_DATA_END = .;
        ARM09R_PL00R09M_2_header_DATA_SIZE = ABSOLUTE(ARM09R_PL00R09M_2_header_DATA_END - ARM09R_PL00R09M_2_header_DATA_START);
    }
    __romPos += SIZEOF(.ARM09R_PL00R09M_2_header);
    ARM09R_PL00R09M_2_header_ROM_END = __romPos;
    ARM09R_PL00R09M_2_header_VRAM_END = .;

    ARM09R_PL00R09M_2_ROM_START = __romPos;
    ARM09R_PL00R09M_2_VRAM = ADDR(.ARM09R_PL00R09M_2);
    .ARM09R_PL00R09M_2 0x800EF600 : AT(ARM09R_PL00R09M_2_ROM_START) SUBALIGN(4)
    {
        ARM09R_PL00R09M_2_DATA_START = .;
        PL00R09M_2_data__s = .;
        build/asm/ARM09R/ovl2__PLBIN_PL00R09M.PBD/data/PL00R09M_2.data.s.o(.data);
        ARM09R_PL00R09M_2_DATA_END = .;
        ARM09R_PL00R09M_2_DATA_SIZE = ABSOLUTE(ARM09R_PL00R09M_2_DATA_END - ARM09R_PL00R09M_2_DATA_START);
    }
    __romPos += SIZEOF(.ARM09R_PL00R09M_2);
    __romPos = ALIGN(__romPos, 16);
    ARM09R_PL00R09M_2_ROM_END = __romPos;
    ARM09R_PL00R09M_2_VRAM_END = .;

    /DISCARD/ :
    {
        *(*);
    }
}
