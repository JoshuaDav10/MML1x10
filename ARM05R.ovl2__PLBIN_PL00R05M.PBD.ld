SECTIONS
{
    __romPos = 0;
    _gp = 0x0;
    ARM05R_PL00R05M_2_header_ROM_START = __romPos;
    ARM05R_PL00R05M_2_header_VRAM = ADDR(.ARM05R_PL00R05M_2_header);
    .ARM05R_PL00R05M_2_header : AT(ARM05R_PL00R05M_2_header_ROM_START) SUBALIGN(16)
    {
        ARM05R_PL00R05M_2_header_DATA_START = .;
        ARM05R_PL00R05M_2_header_s = .;
        build/asm/ARM05R/ovl2__PLBIN_PL00R05M.PBD/ARM05R_PL00R05M_2_header.s.o(.data);
        ARM05R_PL00R05M_2_header_DATA_END = .;
        ARM05R_PL00R05M_2_header_DATA_SIZE = ABSOLUTE(ARM05R_PL00R05M_2_header_DATA_END - ARM05R_PL00R05M_2_header_DATA_START);
    }
    __romPos += SIZEOF(.ARM05R_PL00R05M_2_header);
    ARM05R_PL00R05M_2_header_ROM_END = __romPos;
    ARM05R_PL00R05M_2_header_VRAM_END = .;

    ARM05R_PL00R05M_2_ROM_START = __romPos;
    ARM05R_PL00R05M_2_VRAM = ADDR(.ARM05R_PL00R05M_2);
    .ARM05R_PL00R05M_2 0x800EF600 : AT(ARM05R_PL00R05M_2_ROM_START) SUBALIGN(4)
    {
        ARM05R_PL00R05M_2_DATA_START = .;
        PL00R05M_2_data__s = .;
        build/asm/ARM05R/ovl2__PLBIN_PL00R05M.PBD/data/PL00R05M_2.data.s.o(.data);
        ARM05R_PL00R05M_2_DATA_END = .;
        ARM05R_PL00R05M_2_DATA_SIZE = ABSOLUTE(ARM05R_PL00R05M_2_DATA_END - ARM05R_PL00R05M_2_DATA_START);
    }
    __romPos += SIZEOF(.ARM05R_PL00R05M_2);
    __romPos = ALIGN(__romPos, 16);
    ARM05R_PL00R05M_2_ROM_END = __romPos;
    ARM05R_PL00R05M_2_VRAM_END = .;

    /DISCARD/ :
    {
        *(*);
    }
}
