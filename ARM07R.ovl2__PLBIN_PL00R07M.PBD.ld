SECTIONS
{
    __romPos = 0;
    _gp = 0x0;
    ARM07R_PL00R07M_2_header_ROM_START = __romPos;
    ARM07R_PL00R07M_2_header_VRAM = ADDR(.ARM07R_PL00R07M_2_header);
    .ARM07R_PL00R07M_2_header : AT(ARM07R_PL00R07M_2_header_ROM_START) SUBALIGN(16)
    {
        ARM07R_PL00R07M_2_header_DATA_START = .;
        ARM07R_PL00R07M_2_header_s = .;
        build/asm/ARM07R/ovl2__PLBIN_PL00R07M.PBD/ARM07R_PL00R07M_2_header.s.o(.data);
        ARM07R_PL00R07M_2_header_DATA_END = .;
        ARM07R_PL00R07M_2_header_DATA_SIZE = ABSOLUTE(ARM07R_PL00R07M_2_header_DATA_END - ARM07R_PL00R07M_2_header_DATA_START);
    }
    __romPos += SIZEOF(.ARM07R_PL00R07M_2_header);
    ARM07R_PL00R07M_2_header_ROM_END = __romPos;
    ARM07R_PL00R07M_2_header_VRAM_END = .;

    ARM07R_PL00R07M_2_ROM_START = __romPos;
    ARM07R_PL00R07M_2_VRAM = ADDR(.ARM07R_PL00R07M_2);
    .ARM07R_PL00R07M_2 0x800EF600 : AT(ARM07R_PL00R07M_2_ROM_START) SUBALIGN(4)
    {
        ARM07R_PL00R07M_2_DATA_START = .;
        PL00R07M_2_data__s = .;
        build/asm/ARM07R/ovl2__PLBIN_PL00R07M.PBD/data/PL00R07M_2.data.s.o(.data);
        ARM07R_PL00R07M_2_DATA_END = .;
        ARM07R_PL00R07M_2_DATA_SIZE = ABSOLUTE(ARM07R_PL00R07M_2_DATA_END - ARM07R_PL00R07M_2_DATA_START);
    }
    __romPos += SIZEOF(.ARM07R_PL00R07M_2);
    __romPos = ALIGN(__romPos, 16);
    ARM07R_PL00R07M_2_ROM_END = __romPos;
    ARM07R_PL00R07M_2_VRAM_END = .;

    /DISCARD/ :
    {
        *(*);
    }
}
