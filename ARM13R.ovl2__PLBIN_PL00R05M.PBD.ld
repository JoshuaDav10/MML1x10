SECTIONS
{
    __romPos = 0;
    _gp = 0x0;
    ARM13R_PL00R05M_2_header_ROM_START = __romPos;
    ARM13R_PL00R05M_2_header_VRAM = ADDR(.ARM13R_PL00R05M_2_header);
    .ARM13R_PL00R05M_2_header : AT(ARM13R_PL00R05M_2_header_ROM_START) SUBALIGN(16)
    {
        ARM13R_PL00R05M_2_header_DATA_START = .;
        ARM13R_PL00R05M_2_header_s = .;
        build/asm/ARM13R/ovl2__PLBIN_PL00R05M.PBD/ARM13R_PL00R05M_2_header.s.o(.data);
        ARM13R_PL00R05M_2_header_DATA_END = .;
        ARM13R_PL00R05M_2_header_DATA_SIZE = ABSOLUTE(ARM13R_PL00R05M_2_header_DATA_END - ARM13R_PL00R05M_2_header_DATA_START);
    }
    __romPos += SIZEOF(.ARM13R_PL00R05M_2_header);
    ARM13R_PL00R05M_2_header_ROM_END = __romPos;
    ARM13R_PL00R05M_2_header_VRAM_END = .;

    ARM13R_PL00R05M_2_ROM_START = __romPos;
    ARM13R_PL00R05M_2_VRAM = ADDR(.ARM13R_PL00R05M_2);
    .ARM13R_PL00R05M_2 0x800EF600 : AT(ARM13R_PL00R05M_2_ROM_START) SUBALIGN(4)
    {
        ARM13R_PL00R05M_2_DATA_START = .;
        PL00R05M_2_data__s = .;
        build/asm/ARM13R/ovl2__PLBIN_PL00R05M.PBD/data/PL00R05M_2.data.s.o(.data);
        ARM13R_PL00R05M_2_DATA_END = .;
        ARM13R_PL00R05M_2_DATA_SIZE = ABSOLUTE(ARM13R_PL00R05M_2_DATA_END - ARM13R_PL00R05M_2_DATA_START);
    }
    __romPos += SIZEOF(.ARM13R_PL00R05M_2);
    __romPos = ALIGN(__romPos, 16);
    ARM13R_PL00R05M_2_ROM_END = __romPos;
    ARM13R_PL00R05M_2_VRAM_END = .;

    /DISCARD/ :
    {
        *(*);
    }
}
