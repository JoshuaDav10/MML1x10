SECTIONS
{
    __romPos = 0;
    _gp = 0x0;
    ARM07R_PL00R07P_3_header_ROM_START = __romPos;
    ARM07R_PL00R07P_3_header_VRAM = ADDR(.ARM07R_PL00R07P_3_header);
    .ARM07R_PL00R07P_3_header : AT(ARM07R_PL00R07P_3_header_ROM_START) SUBALIGN(16)
    {
        ARM07R_PL00R07P_3_header_DATA_START = .;
        ARM07R_PL00R07P_3_header_s = .;
        build/asm/ARM07R/ovl3__PLBIN_PL00R07P.PBD/ARM07R_PL00R07P_3_header.s.o(.data);
        ARM07R_PL00R07P_3_header_DATA_END = .;
        ARM07R_PL00R07P_3_header_DATA_SIZE = ABSOLUTE(ARM07R_PL00R07P_3_header_DATA_END - ARM07R_PL00R07P_3_header_DATA_START);
    }
    __romPos += SIZEOF(.ARM07R_PL00R07P_3_header);
    ARM07R_PL00R07P_3_header_ROM_END = __romPos;
    ARM07R_PL00R07P_3_header_VRAM_END = .;

    ARM07R_PL00R07P_3_ROM_START = __romPos;
    ARM07R_PL00R07P_3_VRAM = ADDR(.ARM07R_PL00R07P_3);
    .ARM07R_PL00R07P_3 0x800FB500 : AT(ARM07R_PL00R07P_3_ROM_START) SUBALIGN(4)
    {
        ARM07R_PL00R07P_3_DATA_START = .;
        PL00R07P_3_data__s = .;
        build/asm/ARM07R/ovl3__PLBIN_PL00R07P.PBD/data/PL00R07P_3.data.s.o(.data);
        ARM07R_PL00R07P_3_DATA_END = .;
        ARM07R_PL00R07P_3_DATA_SIZE = ABSOLUTE(ARM07R_PL00R07P_3_DATA_END - ARM07R_PL00R07P_3_DATA_START);
    }
    __romPos += SIZEOF(.ARM07R_PL00R07P_3);
    __romPos = ALIGN(__romPos, 16);
    ARM07R_PL00R07P_3_ROM_END = __romPos;
    ARM07R_PL00R07P_3_VRAM_END = .;

    /DISCARD/ :
    {
        *(*);
    }
}
