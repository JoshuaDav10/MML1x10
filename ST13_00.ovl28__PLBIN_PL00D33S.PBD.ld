SECTIONS
{
    __romPos = 0;
    _gp = 0x0;
    ST13_00_PL00D33S_28_header_ROM_START = __romPos;
    ST13_00_PL00D33S_28_header_VRAM = ADDR(.ST13_00_PL00D33S_28_header);
    .ST13_00_PL00D33S_28_header : AT(ST13_00_PL00D33S_28_header_ROM_START) SUBALIGN(16)
    {
        ST13_00_PL00D33S_28_header_DATA_START = .;
        ST13_00_PL00D33S_28_header_s = .;
        build/asm/ST13_00/ovl28__PLBIN_PL00D33S.PBD/ST13_00_PL00D33S_28_header.s.o(.data);
        ST13_00_PL00D33S_28_header_DATA_END = .;
        ST13_00_PL00D33S_28_header_DATA_SIZE = ABSOLUTE(ST13_00_PL00D33S_28_header_DATA_END - ST13_00_PL00D33S_28_header_DATA_START);
    }
    __romPos += SIZEOF(.ST13_00_PL00D33S_28_header);
    ST13_00_PL00D33S_28_header_ROM_END = __romPos;
    ST13_00_PL00D33S_28_header_VRAM_END = .;

    ST13_00_PL00D33S_28_ROM_START = __romPos;
    ST13_00_PL00D33S_28_VRAM = ADDR(.ST13_00_PL00D33S_28);
    .ST13_00_PL00D33S_28 0x800DBA00 : AT(ST13_00_PL00D33S_28_ROM_START) SUBALIGN(4)
    {
        ST13_00_PL00D33S_28_DATA_START = .;
        PL00D33S_28_data__s = .;
        build/asm/ST13_00/ovl28__PLBIN_PL00D33S.PBD/data/PL00D33S_28.data.s.o(.data);
        ST13_00_PL00D33S_28_DATA_END = .;
        ST13_00_PL00D33S_28_DATA_SIZE = ABSOLUTE(ST13_00_PL00D33S_28_DATA_END - ST13_00_PL00D33S_28_DATA_START);
    }
    __romPos += SIZEOF(.ST13_00_PL00D33S_28);
    __romPos = ALIGN(__romPos, 16);
    ST13_00_PL00D33S_28_ROM_END = __romPos;
    ST13_00_PL00D33S_28_VRAM_END = .;

    /DISCARD/ :
    {
        *(*);
    }
}
