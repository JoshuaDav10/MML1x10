SECTIONS
{
    __romPos = 0;
    _gp = 0x0;
    ARM06R_PL00R06S_1_header_ROM_START = __romPos;
    ARM06R_PL00R06S_1_header_VRAM = ADDR(.ARM06R_PL00R06S_1_header);
    .ARM06R_PL00R06S_1_header : AT(ARM06R_PL00R06S_1_header_ROM_START) SUBALIGN(16)
    {
        ARM06R_PL00R06S_1_header_DATA_START = .;
        ARM06R_PL00R06S_1_header_s = .;
        build/asm/ARM06R/ovl1__PLBIN_PL00R06S.PBD/ARM06R_PL00R06S_1_header.s.o(.data);
        ARM06R_PL00R06S_1_header_DATA_END = .;
        ARM06R_PL00R06S_1_header_DATA_SIZE = ABSOLUTE(ARM06R_PL00R06S_1_header_DATA_END - ARM06R_PL00R06S_1_header_DATA_START);
    }
    __romPos += SIZEOF(.ARM06R_PL00R06S_1_header);
    ARM06R_PL00R06S_1_header_ROM_END = __romPos;
    ARM06R_PL00R06S_1_header_VRAM_END = .;

    ARM06R_PL00R06S_1_ROM_START = __romPos;
    ARM06R_PL00R06S_1_VRAM = ADDR(.ARM06R_PL00R06S_1);
    .ARM06R_PL00R06S_1 0x800DC880 : AT(ARM06R_PL00R06S_1_ROM_START) SUBALIGN(4)
    {
        ARM06R_PL00R06S_1_DATA_START = .;
        PL00R06S_1_data__s = .;
        build/asm/ARM06R/ovl1__PLBIN_PL00R06S.PBD/data/PL00R06S_1.data.s.o(.data);
        ARM06R_PL00R06S_1_DATA_END = .;
        ARM06R_PL00R06S_1_DATA_SIZE = ABSOLUTE(ARM06R_PL00R06S_1_DATA_END - ARM06R_PL00R06S_1_DATA_START);
    }
    __romPos += SIZEOF(.ARM06R_PL00R06S_1);
    __romPos = ALIGN(__romPos, 16);
    ARM06R_PL00R06S_1_ROM_END = __romPos;
    ARM06R_PL00R06S_1_VRAM_END = .;

    /DISCARD/ :
    {
        *(*);
    }
}
