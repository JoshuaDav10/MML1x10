SECTIONS
{
    __romPos = 0;
    _gp = 0x0;
    ARM08R_PL00R08S_1_header_ROM_START = __romPos;
    ARM08R_PL00R08S_1_header_VRAM = ADDR(.ARM08R_PL00R08S_1_header);
    .ARM08R_PL00R08S_1_header : AT(ARM08R_PL00R08S_1_header_ROM_START) SUBALIGN(16)
    {
        ARM08R_PL00R08S_1_header_DATA_START = .;
        ARM08R_PL00R08S_1_header_s = .;
        build/asm/ARM08R/ovl1__PLBIN_PL00R08S.PBD/ARM08R_PL00R08S_1_header.s.o(.data);
        ARM08R_PL00R08S_1_header_DATA_END = .;
        ARM08R_PL00R08S_1_header_DATA_SIZE = ABSOLUTE(ARM08R_PL00R08S_1_header_DATA_END - ARM08R_PL00R08S_1_header_DATA_START);
    }
    __romPos += SIZEOF(.ARM08R_PL00R08S_1_header);
    ARM08R_PL00R08S_1_header_ROM_END = __romPos;
    ARM08R_PL00R08S_1_header_VRAM_END = .;

    ARM08R_PL00R08S_1_ROM_START = __romPos;
    ARM08R_PL00R08S_1_VRAM = ADDR(.ARM08R_PL00R08S_1);
    .ARM08R_PL00R08S_1 0x800DC880 : AT(ARM08R_PL00R08S_1_ROM_START) SUBALIGN(4)
    {
        ARM08R_PL00R08S_1_DATA_START = .;
        PL00R08S_1_data__s = .;
        build/asm/ARM08R/ovl1__PLBIN_PL00R08S.PBD/data/PL00R08S_1.data.s.o(.data);
        ARM08R_PL00R08S_1_DATA_END = .;
        ARM08R_PL00R08S_1_DATA_SIZE = ABSOLUTE(ARM08R_PL00R08S_1_DATA_END - ARM08R_PL00R08S_1_DATA_START);
    }
    __romPos += SIZEOF(.ARM08R_PL00R08S_1);
    __romPos = ALIGN(__romPos, 16);
    ARM08R_PL00R08S_1_ROM_END = __romPos;
    ARM08R_PL00R08S_1_VRAM_END = .;

    /DISCARD/ :
    {
        *(*);
    }
}
