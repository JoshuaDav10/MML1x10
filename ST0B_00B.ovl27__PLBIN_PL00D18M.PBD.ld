SECTIONS
{
    __romPos = 0;
    _gp = 0x0;
    ST0B_00B_PL00D18M_27_header_ROM_START = __romPos;
    ST0B_00B_PL00D18M_27_header_VRAM = ADDR(.ST0B_00B_PL00D18M_27_header);
    .ST0B_00B_PL00D18M_27_header : AT(ST0B_00B_PL00D18M_27_header_ROM_START) SUBALIGN(16)
    {
        ST0B_00B_PL00D18M_27_header_DATA_START = .;
        ST0B_00B_PL00D18M_27_header_s = .;
        build/asm/ST0B_00B/ovl27__PLBIN_PL00D18M.PBD/ST0B_00B_PL00D18M_27_header.s.o(.data);
        ST0B_00B_PL00D18M_27_header_DATA_END = .;
        ST0B_00B_PL00D18M_27_header_DATA_SIZE = ABSOLUTE(ST0B_00B_PL00D18M_27_header_DATA_END - ST0B_00B_PL00D18M_27_header_DATA_START);
    }
    __romPos += SIZEOF(.ST0B_00B_PL00D18M_27_header);
    ST0B_00B_PL00D18M_27_header_ROM_END = __romPos;
    ST0B_00B_PL00D18M_27_header_VRAM_END = .;

    ST0B_00B_PL00D18M_27_ROM_START = __romPos;
    ST0B_00B_PL00D18M_27_VRAM = ADDR(.ST0B_00B_PL00D18M_27);
    .ST0B_00B_PL00D18M_27 0x800E9600 : AT(ST0B_00B_PL00D18M_27_ROM_START) SUBALIGN(4)
    {
        ST0B_00B_PL00D18M_27_DATA_START = .;
        PL00D18M_27_data__s = .;
        build/asm/ST0B_00B/ovl27__PLBIN_PL00D18M.PBD/data/PL00D18M_27.data.s.o(.data);
        ST0B_00B_PL00D18M_27_DATA_END = .;
        ST0B_00B_PL00D18M_27_DATA_SIZE = ABSOLUTE(ST0B_00B_PL00D18M_27_DATA_END - ST0B_00B_PL00D18M_27_DATA_START);
    }
    __romPos += SIZEOF(.ST0B_00B_PL00D18M_27);
    __romPos = ALIGN(__romPos, 16);
    ST0B_00B_PL00D18M_27_ROM_END = __romPos;
    ST0B_00B_PL00D18M_27_VRAM_END = .;

    /DISCARD/ :
    {
        *(*);
    }
}
