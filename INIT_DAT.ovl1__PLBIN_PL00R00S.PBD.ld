SECTIONS
{
    __romPos = 0;
    _gp = 0x0;
    INIT_DAT_PL00R00S_1_header_ROM_START = __romPos;
    INIT_DAT_PL00R00S_1_header_VRAM = ADDR(.INIT_DAT_PL00R00S_1_header);
    .INIT_DAT_PL00R00S_1_header : AT(INIT_DAT_PL00R00S_1_header_ROM_START) SUBALIGN(16)
    {
        INIT_DAT_PL00R00S_1_header_DATA_START = .;
        INIT_DAT_PL00R00S_1_header_s = .;
        build/asm/INIT_DAT/ovl1__PLBIN_PL00R00S.PBD/INIT_DAT_PL00R00S_1_header.s.o(.data);
        INIT_DAT_PL00R00S_1_header_DATA_END = .;
        INIT_DAT_PL00R00S_1_header_DATA_SIZE = ABSOLUTE(INIT_DAT_PL00R00S_1_header_DATA_END - INIT_DAT_PL00R00S_1_header_DATA_START);
    }
    __romPos += SIZEOF(.INIT_DAT_PL00R00S_1_header);
    INIT_DAT_PL00R00S_1_header_ROM_END = __romPos;
    INIT_DAT_PL00R00S_1_header_VRAM_END = .;

    INIT_DAT_PL00R00S_1_ROM_START = __romPos;
    INIT_DAT_PL00R00S_1_VRAM = ADDR(.INIT_DAT_PL00R00S_1);
    .INIT_DAT_PL00R00S_1 0x800DC400 : AT(INIT_DAT_PL00R00S_1_ROM_START) SUBALIGN(4)
    {
        INIT_DAT_PL00R00S_1_DATA_START = .;
        PL00R00S_1_data__s = .;
        build/asm/INIT_DAT/ovl1__PLBIN_PL00R00S.PBD/data/PL00R00S_1.data.s.o(.data);
        INIT_DAT_PL00R00S_1_DATA_END = .;
        INIT_DAT_PL00R00S_1_DATA_SIZE = ABSOLUTE(INIT_DAT_PL00R00S_1_DATA_END - INIT_DAT_PL00R00S_1_DATA_START);
    }
    __romPos += SIZEOF(.INIT_DAT_PL00R00S_1);
    __romPos = ALIGN(__romPos, 16);
    INIT_DAT_PL00R00S_1_ROM_END = __romPos;
    INIT_DAT_PL00R00S_1_VRAM_END = .;

    /DISCARD/ :
    {
        *(*);
    }
}
