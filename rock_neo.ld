SECTIONS
{
    __romPos = 0;
    _gp = 0x80097864;
    header_ROM_START = __romPos;
    header_VRAM = ADDR(.header);
    .header : AT(header_ROM_START) SUBALIGN(16)
    {
        header_DATA_START = .;
        header_s = .;
        build/asm/rock_neo/header.s.o(.data);
        header_DATA_END = .;
        header_DATA_SIZE = ABSOLUTE(header_DATA_END - header_DATA_START);
    }
    __romPos += SIZEOF(.header);
    header_ROM_END = __romPos;
    header_VRAM_END = .;

    main_ROM_START = __romPos;
    main_VRAM = ADDR(.main);
    .main 0x80010000 : AT(main_ROM_START) SUBALIGN(4)
    {
        main_RODATA_START = .;
        build/asm/rock_neo/data/800.rodata.s.o(.rodata);
        main_RODATA_END = .;
        main_RODATA_SIZE = ABSOLUTE(main_RODATA_END - main_RODATA_START);
        main_TEXT_START = .;
        build/src/rock_neo/main.c.o(.text);
        build/src/rock_neo/Code800133D8.c.o(.text);
        main_DATA_START = .;
        _23972_data__s = .;
        build/asm/rock_neo/data/23972.data.s.o(.data);
        build/src/rock_neo/game.c.o(.text);
        _30680_data__s = .;
        build/asm/rock_neo/data/30680.data.s.o(.data);
        build/src/rock_neo/FUN_800177d8.c.o(.text);
        build/src/rock_neo/FUN_80017898.c.o(.text);
        build/src/rock_neo/FUN_80017958.c.o(.text);
        build/src/rock_neo/FUN_80017a14.c.o(.text);
        build/src/rock_neo/FUN_80017af8.c.o(.text);
        build/src/rock_neo/FUN_80017bb8.c.o(.text);
        build/src/rock_neo/FUN_80017c7c.c.o(.text);
        build/src/rock_neo/FUN_80017d2c.c.o(.text);
        build/src/rock_neo/FUN_80017f38.c.o(.text);
        _32779_data__s = .;
        build/asm/rock_neo/data/32779.data.s.o(.data);
        build/src/rock_neo/FUN_8008000C.c.o(.text);
        build/src/rock_neo/FUN_8008070.c.o(.text);
        build/src/rock_neo/FUN_80018100.c.o(.text);
        build/src/rock_neo/FUN_80018198.c.o(.text);
        _34900_data__s = .;
        build/asm/rock_neo/data/34900.data.s.o(.data);
        build/src/rock_neo/FUN_80018854.c.o(.text);
        _37820_data__s = .;
        build/asm/rock_neo/data/37820.data.s.o(.data);
        build/src/rock_neo/FUN_800193bc.c.o(.text);
        _40804_data__s = .;
        build/asm/rock_neo/data/40804.data.s.o(.data);
        build/src/rock_neo/FUN_80019f64.c.o(.text);
        _41156_data__s = .;
        build/asm/rock_neo/data/41156.data.s.o(.data);
        build/src/rock_neo/FUN_8001a0c4.c.o(.text);
        build/src/rock_neo/sound.c.o(.text);
        build/src/rock_neo/cd.c.o(.text);
        build/src/rock_neo/scene.c.o(.text);
        build/src/rock_neo/FUN_800100b0.c.o(.text);
        _10638_data__s = .;
        build/asm/rock_neo/data/10638.data.s.o(.data);
        build/src/rock_neo/FUN_80012704.c.o(.text);
        build/src/rock_neo/FUN_800128a8.c.o(.text);
        build/src/rock_neo/FUN_8001295c.c.o(.text);
        build/src/rock_neo/FUN_800129ac.c.o(.text);
        build/src/rock_neo/FUN_80012a98.c.o(.text);
        build/src/rock_neo/FUN_80012ad0.c.o(.text);
        build/src/rock_neo/FUN_80012b4c.c.o(.text);
        build/src/rock_neo/FUN_80012c6c.c.o(.text);
        build/src/rock_neo/FUN_80013138.c.o(.text);
        build/src/rock_neo/FUN_80013188.c.o(.text);
        build/src/rock_neo/FUN_8001325c.c.o(.text);
        build/src/rock_neo/FUN_80013610.c.o(.text);
        build/src/rock_neo/FUN_80013698.c.o(.text);
        build/src/rock_neo/FUN_800136cc.c.o(.text);
        build/src/rock_neo/FUN_80013724.c.o(.text);
        build/src/rock_neo/FUN_80013778.c.o(.text);
        build/src/rock_neo/FUN_800137ec.c.o(.text);
        build/src/rock_neo/FUN_800138d0.c.o(.text);
        build/src/rock_neo/FUN_800139fc.c.o(.text);
        build/src/rock_neo/FUN_80013a6c.c.o(.text);
        build/src/rock_neo/FUN_80013bd8.c.o(.text);
        build/src/rock_neo/FUN_80013c20.c.o(.text);
        build/src/rock_neo/FUN_80013c84.c.o(.text);
        build/src/rock_neo/FUN_80013d60.c.o(.text);
        build/src/rock_neo/FUN_80013e7c.c.o(.text);
        build/src/rock_neo/FUN_80014a3c.c.o(.text);
        build/src/rock_neo/FUN_80015bd0.c.o(.text);
        build/src/rock_neo/FUN_8001a274.c.o(.text);
        build/src/rock_neo/FUN_8001a2a8.c.o(.text);
        build/src/rock_neo/FUN_8001a2e4.c.o(.text);
        build/src/rock_neo/FUN_8001a318.c.o(.text);
        build/src/rock_neo/FUN_8001a42c.c.o(.text);
        build/src/rock_neo/FUN_8001a524.c.o(.text);
        build/src/rock_neo/func_8001B3E4.c.o(.text);
        build/src/rock_neo/func_8001B4C4.c.o(.text);
        build/src/rock_neo/func_8001B4CC.c.o(.text);
        build/src/rock_neo/func_8001B63C.c.o(.text);
        build/src/rock_neo/func_8001B644.c.o(.text);
        build/src/rock_neo/func_8001B6FC.c.o(.text);
        build/src/rock_neo/func_8001B858.c.o(.text);
        build/src/rock_neo/FUN_8001B898.c.o(.text);
        build/src/rock_neo/func_8001C95C.c.o(.text);
        build/src/rock_neo/FUN_8001C9A8.c.o(.text);
        build/src/rock_neo/func_8001CAAC.c.o(.text);
        build/src/rock_neo/func_8001CB7C.c.o(.text);
        build/src/rock_neo/FUN_8001CC04.c.o(.text);
        build/src/rock_neo/func_8001D254.c.o(.text);
        build/src/rock_neo/func_8001D2BC.c.o(.text);
        build/src/rock_neo/func_8001D324.c.o(.text);
        build/src/rock_neo/func_8001D394.c.o(.text);
        build/src/rock_neo/func_8001D414.c.o(.text);
        build/src/rock_neo/Cd_read_comb.c.o(.text);
        build/src/rock_neo/func_8001D468.c.o(.text);
        build/src/rock_neo/func_8001D494.c.o(.text);
        build/src/rock_neo/func_8001D58C.c.o(.text);
        build/src/rock_neo/FUN_8001D5C4.c.o(.text);
        build/src/rock_neo/FUN_8001D7E4.c.o(.text);
        build/src/rock_neo/Cd_read_sync2.c.o(.text);
        build/src/rock_neo/FUN_80020058.c.o(.text);
        build/src/rock_neo/FUN_80020094.c.o(.text);
        build/src/rock_neo/FUN_800200A4.c.o(.text);
        build/src/rock_neo/FUN_800200B4.c.o(.text);
        build/src/rock_neo/FUN_800200C4.c.o(.text);
        build/src/rock_neo/FUN_800200F4.c.o(.text);
        build/src/rock_neo/FUN_8002017C.c.o(.text);
        build/src/rock_neo/FUN_800201A8.c.o(.text);
        build/src/rock_neo/FUN_800201B8.c.o(.text);
        build/src/rock_neo/FUN_800201DC.c.o(.text);
        build/src/rock_neo/FUN_8002030C.c.o(.text);
        build/src/rock_neo/FUN_800203A0.c.o(.text);
        build/src/rock_neo/FUN_80020400.c.o(.text);
        build/src/rock_neo/FUN_80020AF0.c.o(.text);
        build/src/rock_neo/FUN_80021194.c.o(.text);
        build/src/rock_neo/FUN_800212FC.c.o(.text);
        build/src/rock_neo/FUN_800219A0.c.o(.text);
        build/src/rock_neo/FUN_80021C90.c.o(.text);
        build/src/rock_neo/FUN_80021F04.c.o(.text);
        build/src/rock_neo/FUN_80021F7C.c.o(.text);
        build/src/rock_neo/FUN_800220B4.c.o(.text);
        build/src/rock_neo/FUN_8002215C.c.o(.text);
        build/src/rock_neo/FUN_800221AC.c.o(.text);
        build/src/rock_neo/FUN_8002225c.c.o(.text);
        build/src/rock_neo/FUN_80022928.c.o(.text);
        build/src/rock_neo/player.c.o(.text);
        build/src/rock_neo/func_8002E7A8.c.o(.text);
        build/src/rock_neo/func_8002F9C4.c.o(.text);
        build/src/rock_neo/FUN_8002F9E8.c.o(.text);
        build/src/rock_neo/FUN_8002FA54.c.o(.text);
        build/src/rock_neo/FUN_8002FB68.c.o(.text);
        build/src/rock_neo/FUN_8002FBD8.c.o(.text);
        build/src/rock_neo/FUN_8002FD80.c.o(.text);
        build/src/rock_neo/FUN_8003010C.c.o(.text);
        build/src/rock_neo/FUN_80030134.c.o(.text);
        build/src/rock_neo/FUN_80030158.c.o(.text);
        build/src/rock_neo/FUN_80030180.c.o(.text);
        build/src/rock_neo/FUN_80030278.c.o(.text);
        build/src/rock_neo/FUN_800302C4.c.o(.text);
        build/src/rock_neo/FUN_800302F0.c.o(.text);
        build/src/rock_neo/FUN_8003033C.c.o(.text);
        build/src/rock_neo/FUN_800305BC.c.o(.text);
        build/src/rock_neo/FUN_800305EC.c.o(.text);
        build/src/rock_neo/FUN_8003067C.c.o(.text);
        build/src/rock_neo/FUN_8003070C.c.o(.text);
        build/src/rock_neo/FUN_80030740.c.o(.text);
        build/src/rock_neo/FUN_800307A0.c.o(.text);
        build/src/rock_neo/FUN_800308F0.c.o(.text);
        build/src/rock_neo/FUN_80030988.c.o(.text);
        build/src/rock_neo/FUN_8003099C.c.o(.text);
        build/src/rock_neo/FUN_80030A2C.c.o(.text);
        build/src/rock_neo/FUN_80030A4C.c.o(.text);
        build/src/rock_neo/FUN_80030ABC.c.o(.text);
        build/src/rock_neo/FUN_80030B60.c.o(.text);
        build/src/rock_neo/FUN_80030BB4.c.o(.text);
        build/src/rock_neo/FUN_80030C18.c.o(.text);
        build/src/rock_neo/FUN_80030D4C.c.o(.text);
        build/src/rock_neo/FUN_80030D70.c.o(.text);
        build/src/rock_neo/FUN_80030F64.c.o(.text);
        build/src/rock_neo/FUN_8003107C.c.o(.text);
        build/src/rock_neo/FUN_800310B0.c.o(.text);
        build/src/rock_neo/FUN_80031128.c.o(.text);
        build/src/rock_neo/FUN_800311A0.c.o(.text);
        build/src/rock_neo/FUN_80031400.c.o(.text);
        build/src/rock_neo/FUN_80031438.c.o(.text);
        build/src/rock_neo/FUN_80031478.c.o(.text);
        build/src/rock_neo/FUN_80031490.c.o(.text);
        build/src/rock_neo/FUN_80031630.c.o(.text);
        build/src/rock_neo/FUN_8003177C.c.o(.text);
        build/src/rock_neo/FUN_80031814.c.o(.text);
        build/src/rock_neo/FUN_80031874.c.o(.text);
        build/src/rock_neo/FUN_800318E0.c.o(.text);
        build/src/rock_neo/FUN_8003196C.c.o(.text);
        build/src/rock_neo/FUN_800319B0.c.o(.text);
        build/src/rock_neo/FUN_800319E4.c.o(.text);
        build/src/rock_neo/FUN_80031A84.c.o(.text);
        build/src/rock_neo/FUN_80031B14.c.o(.text);
        build/src/rock_neo/FUN_80031B60.c.o(.text);
        build/src/rock_neo/FUN_80031BE0.c.o(.text);
        build/src/rock_neo/FUN_80031C60.c.o(.text);
        build/src/rock_neo/FUN_80031CE0.c.o(.text);
        build/src/rock_neo/FUN_80031D70.c.o(.text);
        build/src/rock_neo/FUN_80031E00.c.o(.text);
        build/src/rock_neo/FUN_80031E7C.c.o(.text);
        build/src/rock_neo/FUN_80031F40.c.o(.text);
        build/src/rock_neo/FUN_80031F9C.c.o(.text);
        build/src/rock_neo/FUN_80032000.c.o(.text);
        build/src/rock_neo/FUN_80032068.c.o(.text);
        build/src/rock_neo/FUN_800320C0.c.o(.text);
        build/src/rock_neo/FUN_80032114.c.o(.text);
        build/src/rock_neo/FUN_80032128.c.o(.text);
        build/src/rock_neo/FUN_80032160.c.o(.text);
        build/src/rock_neo/FUN_800321A8.c.o(.text);
        build/src/rock_neo/FUN_800322A0.c.o(.text);
        build/src/rock_neo/FUN_80032334.c.o(.text);
        build/src/rock_neo/FUN_8003235C.c.o(.text);
        build/src/rock_neo/FUN_800323EC.c.o(.text);
        build/src/rock_neo/FUN_80032514.c.o(.text);
        build/src/rock_neo/FUN_800325A8.c.o(.text);
        build/src/rock_neo/FUN_80032638.c.o(.text);
        build/src/rock_neo/FUN_800326CC.c.o(.text);
        build/src/rock_neo/FUN_80032800.c.o(.text);
        build/src/rock_neo/FUN_80032870.c.o(.text);
        build/src/rock_neo/FUN_80032978.c.o(.text);
        build/src/rock_neo/FUN_800329F0.c.o(.text);
        build/src/rock_neo/FUN_80032A4C.c.o(.text);
        build/src/rock_neo/FUN_80032A94.c.o(.text);
        build/src/rock_neo/FUN_80032BD0.c.o(.text);
        build/src/rock_neo/FUN_80032C80.c.o(.text);
        build/src/rock_neo/FUN_80032D1C.c.o(.text);
        build/src/rock_neo/FUN_8003308C.c.o(.text);
        build/src/rock_neo/FUN_8003311C.c.o(.text);
        build/src/rock_neo/FUN_800335B4.c.o(.text);
        build/src/rock_neo/FUN_800337FC.c.o(.text);
        build/src/rock_neo/FUN_800338E8.c.o(.text);
        build/src/rock_neo/FUN_80033B70.c.o(.text);
        build/src/rock_neo/FUN_80033BB4.c.o(.text);
        build/src/rock_neo/FUN_80033C08.c.o(.text);
        build/src/rock_neo/FUN_80033C0C.c.o(.text);
        build/src/rock_neo/FUN_80033CE0.c.o(.text);
        build/src/rock_neo/FUN_80033DF0.c.o(.text);
        build/src/rock_neo/FUN_80034170.c.o(.text);
        build/src/rock_neo/FUN_800344C8.c.o(.text);
        build/src/rock_neo/FUN_8003462C.c.o(.text);
        build/src/rock_neo/FUN_8003464C.c.o(.text);
        build/src/rock_neo/FUN_8003466C.c.o(.text);
        build/src/rock_neo/FUN_80034A54.c.o(.text);
        build/src/rock_neo/FUN_80034AF4.c.o(.text);
        build/src/rock_neo/FUN_80034C54.c.o(.text);
        build/src/rock_neo/FUN_80034CB4.c.o(.text);
        build/src/rock_neo/FUN_80034D94.c.o(.text);
        build/src/rock_neo/FUN_80034DF4.c.o(.text);
        build/src/rock_neo/FUN_80034E78.c.o(.text);
        build/src/rock_neo/FUN_80034E94.c.o(.text);
        build/src/rock_neo/FUN_80035600.c.o(.text);
        build/src/rock_neo/FUN_80035848.c.o(.text);
        build/src/rock_neo/FUN_80035C50.c.o(.text);
        build/src/rock_neo/FUN_80035D38.c.o(.text);
        build/src/rock_neo/FUN_80035E6C.c.o(.text);
        build/src/rock_neo/FUN_80036038.c.o(.text);
        build/src/rock_neo/FUN_80036114.c.o(.text);
        build/src/rock_neo/FUN_800363D8.c.o(.text);
        build/src/rock_neo/FUN_800366F4.c.o(.text);
        build/src/rock_neo/FUN_800367B4.c.o(.text);
        build/src/rock_neo/FUN_80036910.c.o(.text);
        build/src/rock_neo/func_8003697C.c.o(.text);
        build/src/rock_neo/FUN_800369DC.c.o(.text);
        build/src/rock_neo/FUN_800369DC.c.o(.text);
        build/src/rock_neo/FUN_80036A4C.c.o(.text);
        build/src/rock_neo/FUN_80036BD4.c.o(.text);
        build/src/rock_neo/FUN_80036BF8.c.o(.text);
        build/src/rock_neo/FUN_800370C4.c.o(.text);
        build/src/rock_neo/FUN_80037108.c.o(.text);
        build/src/rock_neo/FUN_80037164.c.o(.text);
        build/src/rock_neo/FUN_800371D0.c.o(.text);
        build/src/rock_neo/FUN_80037288.c.o(.text);
        build/src/rock_neo/FUN_800372D0.c.o(.text);
        build/src/rock_neo/FUN_80037438.c.o(.text);
        build/src/rock_neo/FUN_80037488.c.o(.text);
        build/src/rock_neo/FUN_800375C0.c.o(.text);
        build/src/rock_neo/FUN_800377B4.c.o(.text);
        build/src/rock_neo/FUN_800378E8.c.o(.text);
        build/src/rock_neo/FUN_80037BE0.c.o(.text);
        build/src/rock_neo/FUN_80037D94.c.o(.text);
        build/src/rock_neo/FUN_80037DDC.c.o(.text);
        build/src/rock_neo/FUN_80037E80.c.o(.text);
        build/src/rock_neo/FUN_80037EC0.c.o(.text);
        build/src/rock_neo/FUN_80037EC4.c.o(.text);
        build/src/rock_neo/FUN_80037F60.c.o(.text);
        build/src/rock_neo/FUN_80037FD8.c.o(.text);
        build/src/rock_neo/FUN_80038264.c.o(.text);
        build/src/rock_neo/FUN_80038304.c.o(.text);
        build/src/rock_neo/FUN_80038530.c.o(.text);
        build/src/rock_neo/FUN_800386FC.c.o(.text);
        build/src/rock_neo/FUN_800387EC.c.o(.text);
        build/src/rock_neo/FUN_800389A0.c.o(.text);
        build/src/rock_neo/FUN_80038A6C.c.o(.text);
        build/src/rock_neo/FUN_80038AB8.c.o(.text);
        build/src/rock_neo/FUN_80038BEC.c.o(.text);
        build/src/rock_neo/FUN_80038C38.c.o(.text);
        build/src/rock_neo/FUN_80038D28.c.o(.text);
        build/src/rock_neo/FUN_80038D90.c.o(.text);
        build/src/rock_neo/FUN_80038DD4.c.o(.text);
        build/src/rock_neo/FUN_80038ED8.c.o(.text);
        build/src/rock_neo/FUN_80038FDC.c.o(.text);
        build/src/rock_neo/FUN_800391A4.c.o(.text);
        build/src/rock_neo/FUN_80039460.c.o(.text);
        build/src/rock_neo/FUN_80039608.c.o(.text);
        build/src/rock_neo/FUN_80039980.c.o(.text);
        build/src/rock_neo/FUN_80039A58.c.o(.text);
        build/src/rock_neo/FUN_80039ADC.c.o(.text);
        build/src/rock_neo/FUN_80039E20.c.o(.text);
        build/src/rock_neo/FUN_80039F48.c.o(.text);
        build/src/rock_neo/FUN_80040098.c.o(.text);
        build/src/rock_neo/FUN_800400C4.c.o(.text);
        build/src/rock_neo/FUN_800400F0.c.o(.text);
        build/src/rock_neo/FUN_800402BC.c.o(.text);
        build/src/rock_neo/FUN_80040470.c.o(.text);
        build/src/rock_neo/FUN_80040498.c.o(.text);
        build/src/rock_neo/FUN_800404F0.c.o(.text);
        build/src/rock_neo/FUN_80040534.c.o(.text);
        build/src/rock_neo/FUN_80040564.c.o(.text);
        build/src/rock_neo/FUN_80040570.c.o(.text);
        build/src/rock_neo/FUN_80040688.c.o(.text);
        build/src/rock_neo/FUN_800406B0.c.o(.text);
        build/src/rock_neo/FUN_800406EC.c.o(.text);
        build/src/rock_neo/FUN_800406F8.c.o(.text);
        build/src/rock_neo/FUN_80040764.c.o(.text);
        build/src/rock_neo/FUN_80040800.c.o(.text);
        build/src/rock_neo/FUN_80040888.c.o(.text);
        build/src/rock_neo/FUN_800408B0.c.o(.text);
        build/src/rock_neo/FUN_800408C0.c.o(.text);
        build/src/rock_neo/FUN_80040928.c.o(.text);
        build/src/rock_neo/FUN_8004096C.c.o(.text);
        build/src/rock_neo/FUN_800409B8.c.o(.text);
        build/src/rock_neo/FUN_80040B20.c.o(.text);
        build/src/rock_neo/FUN_80040BD8.c.o(.text);
        build/src/rock_neo/FUN_80040C38.c.o(.text);
        build/src/rock_neo/FUN_80040C78.c.o(.text);
        build/src/rock_neo/FUN_80040E04.c.o(.text);
        build/src/rock_neo/FUN_80040EAC.c.o(.text);
        build/src/rock_neo/FUN_80040F60.c.o(.text);
        build/src/rock_neo/FUN_80041014.c.o(.text);
        build/src/rock_neo/FUN_800410E0.c.o(.text);
        build/src/rock_neo/FUN_800411A0.c.o(.text);
        build/src/rock_neo/FUN_800411B0.c.o(.text);
        build/src/rock_neo/FUN_800411E4.c.o(.text);
        build/src/rock_neo/FUN_800411F4.c.o(.text);
        build/src/rock_neo/FUN_80041360.c.o(.text);
        build/src/rock_neo/FUN_800413D8.c.o(.text);
        build/src/rock_neo/FUN_800413E0.c.o(.text);
        build/src/rock_neo/FUN_80041458.c.o(.text);
        build/src/rock_neo/FUN_80041460.c.o(.text);
        build/src/rock_neo/FUN_80041560.c.o(.text);
        build/src/rock_neo/FUN_80041604.c.o(.text);
        build/src/rock_neo/FUN_8004167C.c.o(.text);
        build/src/rock_neo/FUN_8004176C.c.o(.text);
        build/src/rock_neo/FUN_800417C4.c.o(.text);
        build/src/rock_neo/FUN_80041820.c.o(.text);
        build/src/rock_neo/FUN_80041878.c.o(.text);
        build/src/rock_neo/FUN_800418D0.c.o(.text);
        build/src/rock_neo/FUN_8004193C.c.o(.text);
        build/src/rock_neo/FUN_80041994.c.o(.text);
        build/src/rock_neo/FUN_80042000.c.o(.text);
        build/src/rock_neo/FUN_80042110.c.o(.text);
        build/src/rock_neo/FUN_800421D4.c.o(.text);
        build/src/rock_neo/FUN_800421F0.c.o(.text);
        build/src/rock_neo/FUN_800421F8.c.o(.text);
        build/src/rock_neo/FUN_80042294.c.o(.text);
        build/src/rock_neo/FUN_80042344.c.o(.text);
        build/src/rock_neo/FUN_800423D0.c.o(.text);
        build/src/rock_neo/FUN_8004251C.c.o(.text);
        build/src/rock_neo/FUN_800425D8.c.o(.text);
        build/src/rock_neo/FUN_8004263C.c.o(.text);
        build/src/rock_neo/FUN_8004273C.c.o(.text);
        build/src/rock_neo/FUN_8004278C.c.o(.text);
        build/src/rock_neo/FUN_800427DC.c.o(.text);
        build/src/rock_neo/FUN_8004291C.c.o(.text);
        build/src/rock_neo/FUN_80042980.c.o(.text);
        build/src/rock_neo/FUN_80042A5C.c.o(.text);
        build/src/rock_neo/FUN_80042E40.c.o(.text);
        build/src/rock_neo/FUN_80042E7C.c.o(.text);
        build/src/rock_neo/FUN_80042EB8.c.o(.text);
        build/src/rock_neo/FUN_800430E8.c.o(.text);
        build/src/rock_neo/FUN_80043188.c.o(.text);
        build/src/rock_neo/FUN_800432A0.c.o(.text);
        build/src/rock_neo/FUN_800432E8.c.o(.text);
        build/src/rock_neo/FUN_800432FC.c.o(.text);
        build/src/rock_neo/FUN_80043354.c.o(.text);
        build/src/rock_neo/FUN_800433B4.c.o(.text);
        build/src/rock_neo/FUN_800434E0.c.o(.text);
        build/src/rock_neo/FUN_80043540.c.o(.text);
        build/src/rock_neo/FUN_800436C0.c.o(.text);
        build/src/rock_neo/FUN_80043808.c.o(.text);
        build/src/rock_neo/FUN_8004381C.c.o(.text);
        build/src/rock_neo/FUN_80043920.c.o(.text);
        build/src/rock_neo/FUN_80043970.c.o(.text);
        build/src/rock_neo/FUN_80043B08.c.o(.text);
        build/src/rock_neo/FUN_80043B44.c.o(.text);
        build/src/rock_neo/FUN_80043C38.c.o(.text);
        build/src/rock_neo/FUN_80043D04.c.o(.text);
        build/src/rock_neo/FUN_80043D40.c.o(.text);
        build/src/rock_neo/FUN_80043E04.c.o(.text);
        build/src/rock_neo/FUN_80043E4C.c.o(.text);
        build/src/rock_neo/FUN_80043E88.c.o(.text);
        build/src/rock_neo/FUN_80043EF0.c.o(.text);
        build/src/rock_neo/FUN_80043F40.c.o(.text);
        build/src/rock_neo/FUN_80044104.c.o(.text);
        build/src/rock_neo/FUN_800441D4.c.o(.text);
        build/src/rock_neo/FUN_80044254.c.o(.text);
        build/src/rock_neo/FUN_80044454.c.o(.text);
        build/src/rock_neo/FUN_80044548.c.o(.text);
        build/src/rock_neo/FUN_800445C0.c.o(.text);
        build/src/rock_neo/FUN_800445F4.c.o(.text);
        build/src/rock_neo/FUN_8004467C.c.o(.text);
        build/src/rock_neo/FUN_800446B8.c.o(.text);
        build/src/rock_neo/FUN_80044914.c.o(.text);
        build/src/rock_neo/FUN_80044B48.c.o(.text);
        build/src/rock_neo/FUN_80044DDC.c.o(.text);
        build/src/rock_neo/FUN_80044E00.c.o(.text);
        build/src/rock_neo/FUN_80044FBC.c.o(.text);
        build/src/rock_neo/FUN_80045084.c.o(.text);
        build/src/rock_neo/FUN_80045148.c.o(.text);
        build/src/rock_neo/FUN_80045234.c.o(.text);
        build/src/rock_neo/FUN_8004539C.c.o(.text);
        build/src/rock_neo/FUN_800453A4.c.o(.text);
        build/src/rock_neo/FUN_80045410.c.o(.text);
        build/src/rock_neo/FUN_80045428.c.o(.text);
        build/src/rock_neo/FUN_80045508.c.o(.text);
        build/src/rock_neo/FUN_80045724.c.o(.text);
        build/src/rock_neo/FUN_80045780.c.o(.text);
        build/src/rock_neo/FUN_80045838.c.o(.text);
        build/src/rock_neo/FUN_80045980.c.o(.text);
        build/src/rock_neo/FUN_80046090.c.o(.text);
        build/src/rock_neo/FUN_80046108.c.o(.text);
        build/src/rock_neo/FUN_800461DC.c.o(.text);
        build/src/rock_neo/FUN_80046430.c.o(.text);
        build/src/rock_neo/FUN_80046750.c.o(.text);
        build/src/rock_neo/FUN_80046964.c.o(.text);
        build/src/rock_neo/FUN_80046974.c.o(.text);
        build/src/rock_neo/FUN_80046B98.c.o(.text);
        build/src/rock_neo/FUN_80046C88.c.o(.text);
        build/src/rock_neo/FUN_80046D80.c.o(.text);
        build/src/rock_neo/FUN_800470E8.c.o(.text);
        build/src/rock_neo/FUN_80047268.c.o(.text);
        build/src/rock_neo/FUN_80047348.c.o(.text);
        build/src/rock_neo/FUN_80047388.c.o(.text);
        build/src/rock_neo/FUN_800473AC.c.o(.text);
        build/src/rock_neo/FUN_8004757C.c.o(.text);
        build/src/rock_neo/FUN_800475AC.c.o(.text);
        build/src/rock_neo/FUN_800475DC.c.o(.text);
        build/src/rock_neo/FUN_80047760.c.o(.text);
        build/src/rock_neo/FUN_80047C6C.c.o(.text);
        build/src/rock_neo/FUN_80047ECC.c.o(.text);
        build/src/rock_neo/FUN_80047EEC.c.o(.text);
        build/src/rock_neo/FUN_80047F60.c.o(.text);
        build/src/rock_neo/FUN_80047FD8.c.o(.text);
        build/src/rock_neo/FUN_80048000.c.o(.text);
        build/src/rock_neo/FUN_80048088.c.o(.text);
        build/src/rock_neo/FUN_800480B0.c.o(.text);
        build/src/rock_neo/FUN_800480C0.c.o(.text);
        build/src/rock_neo/FUN_800480F8.c.o(.text);
        build/src/rock_neo/FUN_80048128.c.o(.text);
        build/src/rock_neo/FUN_8004816C.c.o(.text);
        build/src/rock_neo/FUN_800481B8.c.o(.text);
        build/src/rock_neo/FUN_80048200.c.o(.text);
        build/src/rock_neo/FUN_8004826C.c.o(.text);
        build/src/rock_neo/FUN_800482B8.c.o(.text);
        build/src/rock_neo/FUN_80048320.c.o(.text);
        build/src/rock_neo/FUN_80048340.c.o(.text);
        build/src/rock_neo/FUN_80048388.c.o(.text);
        build/src/rock_neo/FUN_800483A0.c.o(.text);
        build/src/rock_neo/FUN_800483B8.c.o(.text);
        build/src/rock_neo/FUN_800483C0.c.o(.text);
        build/src/rock_neo/FUN_800483D8.c.o(.text);
        build/src/rock_neo/FUN_800483EC.c.o(.text);
        build/src/rock_neo/FUN_80048420.c.o(.text);
        build/src/rock_neo/FUN_80048520.c.o(.text);
        build/src/rock_neo/FUN_80048590.c.o(.text);
        build/src/rock_neo/FUN_80048610.c.o(.text);
        build/src/rock_neo/FUN_80048700.c.o(.text);
        build/src/rock_neo/FUN_80048780.c.o(.text);
        build/src/rock_neo/FUN_80048800.c.o(.text);
        build/src/rock_neo/FUN_80048880.c.o(.text);
        build/src/rock_neo/FUN_80048900.c.o(.text);
        build/src/rock_neo/FUN_80048980.c.o(.text);
        build/src/rock_neo/FUN_80048A00.c.o(.text);
        build/src/rock_neo/FUN_80048A80.c.o(.text);
        build/src/rock_neo/FUN_80048B00.c.o(.text);
        build/src/rock_neo/FUN_80048B80.c.o(.text);
        build/src/rock_neo/FUN_80048C00.c.o(.text);
        build/src/rock_neo/FUN_80048C80.c.o(.text);
        build/src/rock_neo/FUN_80048D00.c.o(.text);
        build/src/rock_neo/FUN_80048D80.c.o(.text);
        build/src/rock_neo/FUN_80048E00.c.o(.text);
        build/src/rock_neo/FUN_80048E80.c.o(.text);
        build/src/rock_neo/FUN_80048F00.c.o(.text);
        build/src/rock_neo/FUN_80048F80.c.o(.text);
        build/src/rock_neo/FUN_80049000.c.o(.text);
        build/src/rock_neo/FUN_80049080.c.o(.text);
        build/src/rock_neo/FUN_80049100.c.o(.text);
        build/src/rock_neo/FUN_80049180.c.o(.text);
        build/src/rock_neo/FUN_80049200.c.o(.text);
        build/src/rock_neo/FUN_80049280.c.o(.text);
        build/src/rock_neo/FUN_80049300.c.o(.text);
        build/src/rock_neo/FUN_80049378.c.o(.text);
        build/src/rock_neo/FUN_800493D0.c.o(.text);
        build/src/rock_neo/FUN_800493F4.c.o(.text);
        build/src/rock_neo/FUN_80049530.c.o(.text);
        build/src/rock_neo/FUN_80049560.c.o(.text);
        build/src/rock_neo/FUN_80049578.c.o(.text);
        build/src/rock_neo/FUN_800495B4.c.o(.text);
        build/src/rock_neo/FUN_800495EC.c.o(.text);
        build/src/rock_neo/FUN_80049728.c.o(.text);
        build/src/rock_neo/FUN_80049768.c.o(.text);
        build/src/rock_neo/FUN_80049828.c.o(.text);
        build/src/rock_neo/FUN_80049840.c.o(.text);
        build/src/rock_neo/FUN_80049934.c.o(.text);
        build/src/rock_neo/FUN_80049954.c.o(.text);
        build/src/rock_neo/FUN_80049980.c.o(.text);
        build/src/rock_neo/FUN_800499A8.c.o(.text);
        build/src/rock_neo/FUN_80049AC8.c.o(.text);
        build/src/rock_neo/FUN_80049B90.c.o(.text);
        build/src/rock_neo/FUN_80049BB8.c.o(.text);
        build/src/rock_neo/FUN_80049D60.c.o(.text);
        build/src/rock_neo/FUN_80049D98.c.o(.text);
        build/src/rock_neo/FUN_80049EB4.c.o(.text);
        build/src/rock_neo/FUN_80049EF4.c.o(.text);
        build/src/rock_neo/FUN_80049F14.c.o(.text);
        build/src/rock_neo/FUN_80049F44.c.o(.text);
        build/src/rock_neo/FUN_8004A000.c.o(.text);
        build/src/rock_neo/FUN_8004A080.c.o(.text);
        build/src/rock_neo/FUN_8004A100.c.o(.text);
        build/src/rock_neo/FUN_8004A180.c.o(.text);
        build/src/rock_neo/FUN_8004A200.c.o(.text);
        build/src/rock_neo/FUN_8004A280.c.o(.text);
        build/src/rock_neo/FUN_8004A300.c.o(.text);
        build/src/rock_neo/FUN_8004A380.c.o(.text);
        build/src/rock_neo/FUN_8004A400.c.o(.text);
        build/src/rock_neo/FUN_8004A480.c.o(.text);
        build/src/rock_neo/FUN_8004A500.c.o(.text);
        build/src/rock_neo/FUN_8004A580.c.o(.text);
        build/src/rock_neo/FUN_8004A600.c.o(.text);
        build/src/rock_neo/FUN_8004A680.c.o(.text);
        build/src/rock_neo/FUN_8004A700.c.o(.text);
        build/src/rock_neo/FUN_8004A780.c.o(.text);
        build/src/rock_neo/FUN_8004A800.c.o(.text);
        build/src/rock_neo/FUN_8004A880.c.o(.text);
        build/src/rock_neo/FUN_8004A900.c.o(.text);
        build/src/rock_neo/FUN_8004A980.c.o(.text);
        build/src/rock_neo/FUN_8004AA00.c.o(.text);
        build/src/rock_neo/FUN_8004AA80.c.o(.text);
        build/src/rock_neo/FUN_8004AB00.c.o(.text);
        build/src/rock_neo/FUN_8004AB80.c.o(.text);
        build/src/rock_neo/FUN_8004AC00.c.o(.text);
        build/src/rock_neo/FUN_8004AC80.c.o(.text);
        build/src/rock_neo/FUN_8004AD00.c.o(.text);
        build/src/rock_neo/FUN_8004AD80.c.o(.text);
        build/src/rock_neo/FUN_8004AE00.c.o(.text);
        build/src/rock_neo/FUN_8004AE80.c.o(.text);
        build/src/rock_neo/FUN_8004AF00.c.o(.text);
        build/src/rock_neo/FUN_8004AF80.c.o(.text);
        build/src/rock_neo/FUN_8004B000.c.o(.text);
        build/src/rock_neo/FUN_8004B080.c.o(.text);
        build/src/rock_neo/FUN_8004B100.c.o(.text);
        build/src/rock_neo/FUN_8004B100.c.o(.text);
        build/src/rock_neo/FUN_8004B200.c.o(.text);
        build/src/rock_neo/FUN_8004B280.c.o(.text);
        build/src/rock_neo/FUN_8004B300.c.o(.text);
        build/src/rock_neo/FUN_8004B380.c.o(.text);
        build/src/rock_neo/FUN_8004B400.c.o(.text);
        build/src/rock_neo/FUN_8004B480.c.o(.text);
        build/src/rock_neo/FUN_8004B500.c.o(.text);
        build/src/rock_neo/FUN_8004B600.c.o(.text);
        build/src/rock_neo/FUN_8004B680.c.o(.text);
        build/src/rock_neo/FUN_8004B700.c.o(.text);
        build/src/rock_neo/FUN_8004B780.c.o(.text);
        build/src/rock_neo/FUN_8004B800.c.o(.text);
        build/src/rock_neo/FUN_8004B880.c.o(.text);
        build/src/rock_neo/FUN_8004B900.c.o(.text);
        build/src/rock_neo/FUN_8004B980.c.o(.text);
        build/src/rock_neo/FUN_8004BA00.c.o(.text);
        build/src/rock_neo/FUN_8004BA80.c.o(.text);
        build/src/rock_neo/FUN_8004BB00.c.o(.text);
        build/src/rock_neo/FUN_8004BB80.c.o(.text);
        build/src/rock_neo/FUN_8004BC00.c.o(.text);
        build/src/rock_neo/FUN_8004BC80.c.o(.text);
        build/src/rock_neo/FUN_8004BD00.c.o(.text);
        build/src/rock_neo/FUN_8004BD80.c.o(.text);
        build/src/rock_neo/FUN_8004BE00.c.o(.text);
        build/src/rock_neo/FUN_8004BE80.c.o(.text);
        build/src/rock_neo/FUN_8004BF00.c.o(.text);
        build/src/rock_neo/FUN_8004BF80.c.o(.text);
        build/src/rock_neo/FUN_8004C000.c.o(.text);
        build/src/rock_neo/FUN_8004C080.c.o(.text);
        build/src/rock_neo/FUN_8004C100.c.o(.text);
        build/src/rock_neo/FUN_8004C180.c.o(.text);
        build/src/rock_neo/FUN_8004C200.c.o(.text);
        build/src/rock_neo/FUN_8004C220.c.o(.text);
        build/src/rock_neo/FUN_8004C280.c.o(.text);
        build/src/rock_neo/FUN_8004C300.c.o(.text);
        build/src/rock_neo/FUN_8004C360.c.o(.text);
        build/src/rock_neo/FUN_8004C380.c.o(.text);
        build/src/rock_neo/FUN_8004C400.c.o(.text);
        build/src/rock_neo/FUN_8004C420.c.o(.text);
        build/src/rock_neo/FUN_8004C434.c.o(.text);
        build/src/rock_neo/FUN_8004C480.c.o(.text);
        build/src/rock_neo/FUN_8004C500.c.o(.text);
        build/src/rock_neo/FUN_8004C510.c.o(.text);
        build/src/rock_neo/FUN_8004C580.c.o(.text);
        build/src/rock_neo/FUN_8004C600.c.o(.text);
        build/src/rock_neo/FUN_8004C644.c.o(.text);
        build/src/rock_neo/FUN_8004C680.c.o(.text);
        build/src/rock_neo/FUN_8004C700.c.o(.text);
        build/src/rock_neo/FUN_8004C710.c.o(.text);
        build/src/rock_neo/FUN_8004C8B4.c.o(.text);
        build/src/rock_neo/FUN_8004C944.c.o(.text);
        build/src/rock_neo/FUN_8004C948.c.o(.text);
        build/src/rock_neo/FUN_8004C980.c.o(.text);
        build/src/rock_neo/FUN_8004CB1C.c.o(.text);
        build/src/rock_neo/FUN_8004CE24.c.o(.text);
        build/src/rock_neo/FUN_8004CED4.c.o(.text);
        build/src/rock_neo/FUN_8004CFE0.c.o(.text);
        build/src/rock_neo/FUN_8004D054.c.o(.text);
        build/src/rock_neo/FUN_8004D06C.c.o(.text);
        build/src/rock_neo/FUN_8004D104.c.o(.text);
        build/src/rock_neo/FUN_8004D49C.c.o(.text);
        build/src/rock_neo/FUN_8004D670.c.o(.text);
        build/src/rock_neo/FUN_8004D6E4.c.o(.text);
        build/src/rock_neo/FUN_8004D7A4.c.o(.text);
        build/src/rock_neo/FUN_8004D7AC.c.o(.text);
        build/src/rock_neo/FUN_8004DB88.c.o(.text);
        build/src/rock_neo/FUN_8004DC1C.c.o(.text);
        build/src/rock_neo/FUN_8004DEFC.c.o(.text);
        build/src/rock_neo/FUN_8004DF1C.c.o(.text);
        build/src/rock_neo/FUN_8004DF98.c.o(.text);
        build/src/rock_neo/FUN_8004DFB0.c.o(.text);
        build/src/rock_neo/FUN_8004E0D0.c.o(.text);
        build/src/rock_neo/FUN_8004E12C.c.o(.text);
        build/src/rock_neo/FUN_8004E27C.c.o(.text);
        build/src/rock_neo/FUN_8004E338.c.o(.text);
        build/src/rock_neo/FUN_8004E538.c.o(.text);
        build/src/rock_neo/FUN_8004E550.c.o(.text);
        build/src/rock_neo/FUN_8004E72C.c.o(.text);
        build/src/rock_neo/FUN_8004E95C.c.o(.text);
        build/src/rock_neo/FUN_8004E9C8.c.o(.text);
        build/src/rock_neo/FUN_8004ECDC.c.o(.text);
        build/src/rock_neo/FUN_8004EDB0.c.o(.text);
        build/src/rock_neo/FUN_8004EF78.c.o(.text);
        build/src/rock_neo/FUN_8004EFCC.c.o(.text);
        build/src/rock_neo/FUN_8004EFEC.c.o(.text);
        build/src/rock_neo/FUN_8004F060.c.o(.text);
        build/src/rock_neo/FUN_8004F0A0.c.o(.text);
        build/src/rock_neo/FUN_8004F0D0.c.o(.text);
        build/src/rock_neo/FUN_8004F16C.c.o(.text);
        build/src/rock_neo/FUN_8004F31C.c.o(.text);
        build/src/rock_neo/sub_scrn.c.o(.text);
        build/src/rock_neo/FUN_8004F71C.c.o(.text);
        build/src/rock_neo/FUN_8004F8AC.c.o(.text);
        build/src/rock_neo/FUN_8004FC48.c.o(.text);
        build/src/rock_neo/FUN_8004FCC0.c.o(.text);
        build/src/rock_neo/FUN_80050004.c.o(.text);
        build/src/rock_neo/FUN_8005020C.c.o(.text);
        build/src/rock_neo/FUN_80050254.c.o(.text);
        build/src/rock_neo/FUN_800502C8.c.o(.text);
        build/src/rock_neo/FUN_8005031C.c.o(.text);
        build/src/rock_neo/FUN_80050330.c.o(.text);
        build/src/rock_neo/FUN_800503B0.c.o(.text);
        build/src/rock_neo/FUN_800503DC.c.o(.text);
        build/src/rock_neo/FUN_80050444.c.o(.text);
        build/src/rock_neo/FUN_800504BC.c.o(.text);
        build/src/rock_neo/FUN_8005053C.c.o(.text);
        build/src/rock_neo/FUN_800505F0.c.o(.text);
        build/src/rock_neo/FUN_80050624.c.o(.text);
        build/src/rock_neo/FUN_80050658.c.o(.text);
        build/src/rock_neo/FUN_8005065c.c.o(.text);
        build/src/rock_neo/FUN_800506ac.c.o(.text);
        build/src/rock_neo/FUN_80050760.c.o(.text);
        build/src/rock_neo/FUN_80050800.c.o(.text);
        build/src/rock_neo/FUN_80050880.c.o(.text);
        build/src/rock_neo/FUN_80050900.c.o(.text);
        build/src/rock_neo/FUN_8005092c.c.o(.text);
        build/src/rock_neo/FUN_80050930.c.o(.text);
        build/src/rock_neo/FUN_80050980.c.o(.text);
        build/src/rock_neo/FUN_80050A00.c.o(.text);
        build/src/rock_neo/FUN_80050a18.c.o(.text);
        build/src/rock_neo/FUN_80050a34.c.o(.text);
        build/src/rock_neo/FUN_80050A80.c.o(.text);
        build/src/rock_neo/FUN_80050B00.c.o(.text);
        build/src/rock_neo/FUN_80050B80.c.o(.text);
        build/src/rock_neo/FUN_80050C00.c.o(.text);
        build/src/rock_neo/FUN_80050C80.c.o(.text);
        build/src/rock_neo/FUN_80050D00.c.o(.text);
        build/src/rock_neo/FUN_80050d24.c.o(.text);
        build/src/rock_neo/FUN_80050d48.c.o(.text);
        build/src/rock_neo/FUN_80050D80.c.o(.text);
        build/src/rock_neo/FUN_80050de4.c.o(.text);
        build/src/rock_neo/FUN_80050E00.c.o(.text);
        build/src/rock_neo/FUN_80050E80.c.o(.text);
        build/src/rock_neo/FUN_80050ef0.c.o(.text);
        build/src/rock_neo/FUN_80050F00.c.o(.text);
        build/src/rock_neo/FUN_80050F80.c.o(.text);
        build/src/rock_neo/FUN_80050f8c.c.o(.text);
        build/src/rock_neo/FUN_80051000.c.o(.text);
        build/src/rock_neo/FUN_8005101c.c.o(.text);
        build/src/rock_neo/FUN_80051080.c.o(.text);
        build/src/rock_neo/FUN_800510a0.c.o(.text);
        build/src/rock_neo/FUN_80051100.c.o(.text);
        build/src/rock_neo/FUN_80051124.c.o(.text);
        build/src/rock_neo/FUN_80051180.c.o(.text);
        build/src/rock_neo/FUN_80051200.c.o(.text);
        build/src/rock_neo/FUN_80051280.c.o(.text);
        build/src/rock_neo/FUN_80051300.c.o(.text);
        build/src/rock_neo/FUN_80051374.c.o(.text);
        build/src/rock_neo/FUN_80051380.c.o(.text);
        build/src/rock_neo/FUN_80051400.c.o(.text);
        build/src/rock_neo/FUN_80051410.c.o(.text);
        build/src/rock_neo/FUN_80051438.c.o(.text);
        build/src/rock_neo/FUN_80051480.c.o(.text);
        build/src/rock_neo/FUN_80051500.c.o(.text);
        build/src/rock_neo/FUN_80051518.c.o(.text);
        build/src/rock_neo/FUN_80051528.c.o(.text);
        build/src/rock_neo/FUN_80051554.c.o(.text);
        build/src/rock_neo/FUN_80051580.c.o(.text);
        build/src/rock_neo/FUN_80051600.c.o(.text);
        build/src/rock_neo/FUN_80051680.c.o(.text);
        build/src/rock_neo/FUN_80051694.c.o(.text);
        build/src/rock_neo/FUN_80051700.c.o(.text);
        build/src/rock_neo/FUN_80051724.c.o(.text);
        build/src/rock_neo/FUN_80051780.c.o(.text);
        build/src/rock_neo/FUN_80051784.c.o(.text);
        build/src/rock_neo/FUN_80051800.c.o(.text);
        build/src/rock_neo/FUN_80051800.c.o(.text);
        build/src/rock_neo/FUN_80051880.c.o(.text);
        build/src/rock_neo/FUN_80051880.c.o(.text);
        build/src/rock_neo/FUN_80051900.c.o(.text);
        build/src/rock_neo/FUN_80051900.c.o(.text);
        build/src/rock_neo/FUN_80051980.c.o(.text);
        build/src/rock_neo/FUN_80051980.c.o(.text);
        build/src/rock_neo/FUN_80051A00.c.o(.text);
        build/src/rock_neo/FUN_80051A00.c.o(.text);
        build/src/rock_neo/FUN_80051A80.c.o(.text);
        build/src/rock_neo/FUN_80051A80.c.o(.text);
        build/src/rock_neo/FUN_80051B00.c.o(.text);
        build/src/rock_neo/FUN_80051B00.c.o(.text);
        build/src/rock_neo/FUN_80051B80.c.o(.text);
        build/src/rock_neo/FUN_80051B80.c.o(.text);
        build/src/rock_neo/FUN_80051C00.c.o(.text);
        build/src/rock_neo/FUN_80051C00.c.o(.text);
        build/src/rock_neo/FUN_80051C80.c.o(.text);
        build/src/rock_neo/FUN_80051C80.c.o(.text);
        build/src/rock_neo/FUN_80051D00.c.o(.text);
        build/src/rock_neo/FUN_80051D00.c.o(.text);
        build/src/rock_neo/FUN_80051D80.c.o(.text);
        build/src/rock_neo/FUN_80051D80.c.o(.text);
        build/src/rock_neo/FUN_80051E00.c.o(.text);
        build/src/rock_neo/FUN_80051E00.c.o(.text);
        build/src/rock_neo/FUN_80051E80.c.o(.text);
        build/src/rock_neo/FUN_80051E80.c.o(.text);
        build/src/rock_neo/FUN_80051F00.c.o(.text);
        build/src/rock_neo/FUN_80051F00.c.o(.text);
        build/src/rock_neo/FUN_80051F80.c.o(.text);
        build/src/rock_neo/FUN_80051F80.c.o(.text);
        build/src/rock_neo/FUN_80052000.c.o(.text);
        build/src/rock_neo/FUN_80052000.c.o(.text);
        build/src/rock_neo/FUN_80052080.c.o(.text);
        build/src/rock_neo/FUN_80052080.c.o(.text);
        build/src/rock_neo/FUN_80052100.c.o(.text);
        build/src/rock_neo/FUN_80052100.c.o(.text);
        build/src/rock_neo/FUN_80052180.c.o(.text);
        build/src/rock_neo/FUN_80052180.c.o(.text);
        build/src/rock_neo/FUN_80052200.c.o(.text);
        build/src/rock_neo/FUN_80052200.c.o(.text);
        build/src/rock_neo/FUN_80052280.c.o(.text);
        build/src/rock_neo/FUN_80052280.c.o(.text);
        build/src/rock_neo/FUN_80052300.c.o(.text);
        build/src/rock_neo/FUN_80052300.c.o(.text);
        build/src/rock_neo/FUN_80052380.c.o(.text);
        build/src/rock_neo/FUN_80052380.c.o(.text);
        build/src/rock_neo/FUN_80052400.c.o(.text);
        build/src/rock_neo/FUN_80052400.c.o(.text);
        build/src/rock_neo/FUN_80052480.c.o(.text);
        build/src/rock_neo/FUN_80052480.c.o(.text);
        build/src/rock_neo/FUN_80052500.c.o(.text);
        build/src/rock_neo/FUN_80052500.c.o(.text);
        build/src/rock_neo/FUN_80052544.c.o(.text);
        build/src/rock_neo/FUN_80052580.c.o(.text);
        build/src/rock_neo/FUN_800525A4.c.o(.text);
        build/src/rock_neo/FUN_80052600.c.o(.text);
        build/src/rock_neo/FUN_80052640.c.o(.text);
        build/src/rock_neo/FUN_80052650.c.o(.text);
        build/src/rock_neo/FUN_8005267C.c.o(.text);
        build/src/rock_neo/FUN_80052680.c.o(.text);
        build/src/rock_neo/FUN_8005269C.c.o(.text);
        build/src/rock_neo/FUN_800526A8.c.o(.text);
        build/src/rock_neo/FUN_800526B4.c.o(.text);
        build/src/rock_neo/FUN_800526D4.c.o(.text);
        build/src/rock_neo/FUN_80052700.c.o(.text);
        build/src/rock_neo/FUN_80052700.c.o(.text);
        build/src/rock_neo/FUN_80052780.c.o(.text);
        build/src/rock_neo/FUN_80052780.c.o(.text);
        build/src/rock_neo/FUN_80052800.c.o(.text);
        build/src/rock_neo/FUN_80052800.c.o(.text);
        build/src/rock_neo/FUN_80052880.c.o(.text);
        build/src/rock_neo/FUN_80052880.c.o(.text);
        build/src/rock_neo/FUN_80052900.c.o(.text);
        build/src/rock_neo/FUN_80052900.c.o(.text);
        build/src/rock_neo/FUN_80052980.c.o(.text);
        build/src/rock_neo/FUN_80052980.c.o(.text);
        build/src/rock_neo/FUN_80052A00.c.o(.text);
        build/src/rock_neo/FUN_80052A00.c.o(.text);
        build/src/rock_neo/FUN_80052A80.c.o(.text);
        build/src/rock_neo/FUN_80052A80.c.o(.text);
        build/src/rock_neo/FUN_80052B00.c.o(.text);
        build/src/rock_neo/FUN_80052B00.c.o(.text);
        build/src/rock_neo/FUN_80052B80.c.o(.text);
        build/src/rock_neo/FUN_80052B80.c.o(.text);
        build/src/rock_neo/FUN_80052C00.c.o(.text);
        build/src/rock_neo/FUN_80052C00.c.o(.text);
        build/src/rock_neo/FUN_80052C80.c.o(.text);
        build/src/rock_neo/FUN_80052C80.c.o(.text);
        build/src/rock_neo/FUN_80052D00.c.o(.text);
        build/src/rock_neo/FUN_80052D00.c.o(.text);
        build/src/rock_neo/FUN_80052D80.c.o(.text);
        build/src/rock_neo/FUN_80052D80.c.o(.text);
        build/src/rock_neo/FUN_80052E00.c.o(.text);
        build/src/rock_neo/FUN_80052E00.c.o(.text);
        build/src/rock_neo/FUN_80052E80.c.o(.text);
        build/src/rock_neo/FUN_80052E80.c.o(.text);
        build/src/rock_neo/FUN_80052F00.c.o(.text);
        build/src/rock_neo/FUN_80052F00.c.o(.text);
        build/src/rock_neo/FUN_80052F80.c.o(.text);
        build/src/rock_neo/FUN_80052F80.c.o(.text);
        build/src/rock_neo/FUN_80053000.c.o(.text);
        build/src/rock_neo/FUN_80053000.c.o(.text);
        build/src/rock_neo/FUN_80053080.c.o(.text);
        build/src/rock_neo/FUN_80053080.c.o(.text);
        build/src/rock_neo/FUN_80053100.c.o(.text);
        build/src/rock_neo/FUN_80053100.c.o(.text);
        build/src/rock_neo/FUN_80053180.c.o(.text);
        build/src/rock_neo/FUN_800531E0.c.o(.text);
        build/src/rock_neo/FUN_80053200.c.o(.text);
        build/src/rock_neo/FUN_8005324C.c.o(.text);
        build/src/rock_neo/FUN_80053280.c.o(.text);
        build/src/rock_neo/FUN_80053288.c.o(.text);
        build/src/rock_neo/FUN_80053300.c.o(.text);
        build/src/rock_neo/FUN_80053380.c.o(.text);
        build/src/rock_neo/FUN_80053400.c.o(.text);
        build/src/rock_neo/FUN_80053480.c.o(.text);
        build/src/rock_neo/FUN_80053500.c.o(.text);
        build/src/rock_neo/FUN_80053540.c.o(.text);
        build/src/rock_neo/FUN_80053580.c.o(.text);
        build/src/rock_neo/FUN_80053600.c.o(.text);
        build/src/rock_neo/FUN_80053680.c.o(.text);
        build/src/rock_neo/FUN_80053688.c.o(.text);
        build/src/rock_neo/FUN_80053700.c.o(.text);
        build/src/rock_neo/FUN_80053780.c.o(.text);
        build/src/rock_neo/FUN_80053800.c.o(.text);
        build/src/rock_neo/FUN_80053880.c.o(.text);
        build/src/rock_neo/FUN_800538A0.c.o(.text);
        build/src/rock_neo/FUN_80053900.c.o(.text);
        build/src/rock_neo/FUN_80053980.c.o(.text);
        build/src/rock_neo/FUN_80053A00.c.o(.text);
        build/src/rock_neo/FUN_80053A64.c.o(.text);
        build/src/rock_neo/FUN_80053A80.c.o(.text);
        build/src/rock_neo/FUN_80053B00.c.o(.text);
        build/src/rock_neo/FUN_80053B80.c.o(.text);
        build/src/rock_neo/FUN_80053C00.c.o(.text);
        build/src/rock_neo/FUN_80053C28.c.o(.text);
        build/src/rock_neo/FUN_80053C80.c.o(.text);
        build/src/rock_neo/FUN_80053D00.c.o(.text);
        build/src/rock_neo/FUN_80053D28.c.o(.text);
        build/src/rock_neo/FUN_80053D40.c.o(.text);
        build/src/rock_neo/FUN_80053D48.c.o(.text);
        build/src/rock_neo/FUN_80053D80.c.o(.text);
        build/src/rock_neo/FUN_80053DC0.c.o(.text);
        build/src/rock_neo/FUN_80053E00.c.o(.text);
        build/src/rock_neo/FUN_80053E34.c.o(.text);
        build/src/rock_neo/FUN_80053E80.c.o(.text);
        build/src/rock_neo/FUN_80053ED0.c.o(.text);
        build/src/rock_neo/FUN_80053F00.c.o(.text);
        build/src/rock_neo/FUN_80053F74.c.o(.text);
        build/src/rock_neo/FUN_80053F80.c.o(.text);
        build/src/rock_neo/FUN_80054000.c.o(.text);
        build/src/rock_neo/FUN_80054080.c.o(.text);
        build/src/rock_neo/FUN_80054100.c.o(.text);
        build/src/rock_neo/FUN_80054150.c.o(.text);
        build/src/rock_neo/FUN_80054178.c.o(.text);
        build/src/rock_neo/FUN_80054180.c.o(.text);
        build/src/rock_neo/FUN_800541EC.c.o(.text);
        build/src/rock_neo/FUN_80054200.c.o(.text);
        build/src/rock_neo/FUN_80054280.c.o(.text);
        build/src/rock_neo/FUN_80054288.c.o(.text);
        build/src/rock_neo/FUN_80054300.c.o(.text);
        build/src/rock_neo/FUN_80054324.c.o(.text);
        build/src/rock_neo/FUN_80054380.c.o(.text);
        build/src/rock_neo/FUN_800543A8.c.o(.text);
        build/src/rock_neo/FUN_80054400.c.o(.text);
        build/src/rock_neo/FUN_80054480.c.o(.text);
        build/src/rock_neo/FUN_80054500.c.o(.text);
        build/src/rock_neo/FUN_80054580.c.o(.text);
        build/src/rock_neo/FUN_80054600.c.o(.text);
        build/src/rock_neo/FUN_80054680.c.o(.text);
        build/src/rock_neo/FUN_80054700.c.o(.text);
        build/src/rock_neo/FUN_80054780.c.o(.text);
        build/src/rock_neo/FUN_80054800.c.o(.text);
        build/src/rock_neo/FUN_80054880.c.o(.text);
        build/src/rock_neo/FUN_80054900.c.o(.text);
        build/src/rock_neo/FUN_80054980.c.o(.text);
        build/src/rock_neo/FUN_80054A00.c.o(.text);
        build/src/rock_neo/FUN_80054A80.c.o(.text);
        build/src/rock_neo/FUN_80054B00.c.o(.text);
        build/src/rock_neo/FUN_80054B80.c.o(.text);
        build/src/rock_neo/FUN_80054b98.c.o(.text);
        build/src/rock_neo/FUN_80054C00.c.o(.text);
        build/src/rock_neo/FUN_80054C80.c.o(.text);
        _347408_data__s = .;
        build/asm/rock_neo/data/347408.data.s.o(.data);
        build/src/rock_neo/FUN_80054D00.c.o(.text);
        build/src/rock_neo/FUN_80054d10.c.o(.text);
        build/src/rock_neo/FUN_80054D80.c.o(.text);
        build/src/rock_neo/FUN_80054df8.c.o(.text);
        build/src/rock_neo/FUN_80054E00.c.o(.text);
        build/src/rock_neo/FUN_80054E80.c.o(.text);
        build/src/rock_neo/FUN_80054ee0.c.o(.text);
        build/src/rock_neo/FUN_80054F00.c.o(.text);
        build/src/rock_neo/FUN_80054F80.c.o(.text);
        build/src/rock_neo/FUN_80054fbc.c.o(.text);
        build/src/rock_neo/FUN_80055000.c.o(.text);
        build/src/rock_neo/FUN_80055080.c.o(.text);
        build/src/rock_neo/FUN_80055100.c.o(.text);
        build/src/rock_neo/FUN_80055170.c.o(.text);
        build/src/rock_neo/FUN_80055180.c.o(.text);
        build/src/rock_neo/FUN_80055200.c.o(.text);
        build/src/rock_neo/FUN_80055224.c.o(.text);
        build/src/rock_neo/FUN_80055280.c.o(.text);
        build/src/rock_neo/FUN_80055294.c.o(.text);
        build/src/rock_neo/FUN_800552fc.c.o(.text);
        build/src/rock_neo/FUN_80055300.c.o(.text);
        build/src/rock_neo/FUN_80055334.c.o(.text);
        build/src/rock_neo/FUN_80055380.c.o(.text);
        build/src/rock_neo/FUN_80055400.c.o(.text);
        build/src/rock_neo/FUN_80055480.c.o(.text);
        build/src/rock_neo/FUN_80055500.c.o(.text);
        build/src/rock_neo/FUN_80055580.c.o(.text);
        build/src/rock_neo/FUN_8005559c.c.o(.text);
        build/src/rock_neo/FUN_80055600.c.o(.text);
        build/src/rock_neo/FUN_80055680.c.o(.text);
        build/src/rock_neo/FUN_80055700.c.o(.text);
        build/src/rock_neo/FUN_80055780.c.o(.text);
        build/src/rock_neo/FUN_80055800.c.o(.text);
        build/src/rock_neo/FUN_80055880.c.o(.text);
        build/src/rock_neo/FUN_80055900.c.o(.text);
        build/src/rock_neo/FUN_80055980.c.o(.text);
        build/src/rock_neo/FUN_800559fc.c.o(.text);
        build/src/rock_neo/FUN_80055A00.c.o(.text);
        build/src/rock_neo/FUN_80055A80.c.o(.text);
        build/src/rock_neo/FUN_80055a8c.c.o(.text);
        build/src/rock_neo/FUN_80055af0.c.o(.text);
        build/src/rock_neo/FUN_80055B00.c.o(.text);
        build/src/rock_neo/FUN_80055b10.c.o(.text);
        build/src/rock_neo/FUN_80055b38.c.o(.text);
        build/src/rock_neo/FUN_80055B80.c.o(.text);
        build/src/rock_neo/FUN_80055C00.c.o(.text);
        build/src/rock_neo/FUN_80055C80.c.o(.text);
        build/src/rock_neo/FUN_80055D00.c.o(.text);
        build/src/rock_neo/FUN_80055d3c.c.o(.text);
        build/src/rock_neo/FUN_80055D80.c.o(.text);
        build/src/rock_neo/FUN_80055dd0.c.o(.text);
        build/src/rock_neo/FUN_80055E00.c.o(.text);
        build/src/rock_neo/FUN_80055E80.c.o(.text);
        build/src/rock_neo/FUN_80055ee8.c.o(.text);
        build/src/rock_neo/FUN_80055F00.c.o(.text);
        build/src/rock_neo/FUN_80055f00.c.o(.text);
        build/src/rock_neo/FUN_80055F80.c.o(.text);
        build/src/rock_neo/FUN_80056000.c.o(.text);
        build/src/rock_neo/FUN_80056080.c.o(.text);
        build/src/rock_neo/FUN_80056100.c.o(.text);
        build/src/rock_neo/FUN_80056180.c.o(.text);
        build/src/rock_neo/FUN_80056200.c.o(.text);
        build/src/rock_neo/FUN_80056248.c.o(.text);
        build/src/rock_neo/FUN_8005625c.c.o(.text);
        build/src/rock_neo/FUN_80056280.c.o(.text);
        build/src/rock_neo/FUN_800562f8.c.o(.text);
        build/src/rock_neo/FUN_80056300.c.o(.text);
        build/src/rock_neo/FUN_80056364.c.o(.text);
        build/src/rock_neo/FUN_80056380.c.o(.text);
        build/src/rock_neo/FUN_80056400.c.o(.text);
        build/src/rock_neo/FUN_8005640c.c.o(.text);
        build/src/rock_neo/FUN_80056480.c.o(.text);
        build/src/rock_neo/FUN_80056500.c.o(.text);
        build/src/rock_neo/FUN_80056580.c.o(.text);
        build/src/rock_neo/FUN_80056600.c.o(.text);
        build/src/rock_neo/FUN_80056680.c.o(.text);
        build/src/rock_neo/FUN_80056700.c.o(.text);
        build/src/rock_neo/FUN_80056780.c.o(.text);
        build/src/rock_neo/FUN_800567d8.c.o(.text);
        build/src/rock_neo/FUN_80056800.c.o(.text);
        build/src/rock_neo/FUN_80056880.c.o(.text);
        build/src/rock_neo/FUN_80056900.c.o(.text);
        build/src/rock_neo/FUN_80056954.c.o(.text);
        build/src/rock_neo/FUN_80056980.c.o(.text);
        build/src/rock_neo/FUN_800569c8.c.o(.text);
        build/src/rock_neo/FUN_80056A00.c.o(.text);
        build/src/rock_neo/FUN_80056a7c.c.o(.text);
        build/src/rock_neo/FUN_80056A80.c.o(.text);
        build/src/rock_neo/FUN_80056B00.c.o(.text);
        build/src/rock_neo/FUN_80056B80.c.o(.text);
        build/src/rock_neo/FUN_80056C00.c.o(.text);
        build/src/rock_neo/FUN_80056c10.c.o(.text);
        build/src/rock_neo/FUN_80056C80.c.o(.text);
        build/src/rock_neo/FUN_80056ca0.c.o(.text);
        build/src/rock_neo/FUN_80056D00.c.o(.text);
        build/src/rock_neo/FUN_80056d58.c.o(.text);
        build/src/rock_neo/FUN_80056D80.c.o(.text);
        build/src/rock_neo/FUN_80056E00.c.o(.text);
        build/src/rock_neo/FUN_80056e14.c.o(.text);
        build/src/rock_neo/FUN_80056E80.c.o(.text);
        build/src/rock_neo/FUN_80056e80.c.o(.text);
        build/src/rock_neo/FUN_80056F00.c.o(.text);
        build/src/rock_neo/FUN_80056F80.c.o(.text);
        build/src/rock_neo/FUN_80057000.c.o(.text);
        build/src/rock_neo/FUN_80057080.c.o(.text);
        build/src/rock_neo/FUN_80057100.c.o(.text);
        build/src/rock_neo/FUN_80057180.c.o(.text);
        build/src/rock_neo/FUN_80057200.c.o(.text);
        build/src/rock_neo/FUN_80057280.c.o(.text);
        build/src/rock_neo/FUN_80057300.c.o(.text);
        build/src/rock_neo/FUN_80057380.c.o(.text);
        build/src/rock_neo/FUN_80057400.c.o(.text);
        build/src/rock_neo/FUN_80057480.c.o(.text);
        build/src/rock_neo/FUN_80057500.c.o(.text);
        build/src/rock_neo/FUN_80057580.c.o(.text);
        build/src/rock_neo/FUN_80057600.c.o(.text);
        build/src/rock_neo/FUN_80057680.c.o(.text);
        build/src/rock_neo/FUN_80057700.c.o(.text);
        build/src/rock_neo/FUN_80057780.c.o(.text);
        build/src/rock_neo/FUN_800577f8.c.o(.text);
        build/src/rock_neo/FUN_80057800.c.o(.text);
        build/src/rock_neo/FUN_80057880.c.o(.text);
        build/src/rock_neo/FUN_8005788c.c.o(.text);
        build/src/rock_neo/FUN_800578cc.c.o(.text);
        build/src/rock_neo/FUN_80057900.c.o(.text);
        build/src/rock_neo/FUN_80057980.c.o(.text);
        build/src/rock_neo/FUN_80057A00.c.o(.text);
        build/src/rock_neo/FUN_80057a10.c.o(.text);
        build/src/rock_neo/FUN_80057A80.c.o(.text);
        build/src/rock_neo/FUN_80057B00.c.o(.text);
        build/src/rock_neo/FUN_80057b40.c.o(.text);
        build/src/rock_neo/FUN_80057b50.c.o(.text);
        build/src/rock_neo/FUN_80057B80.c.o(.text);
        build/src/rock_neo/FUN_80057bcc.c.o(.text);
        build/src/rock_neo/FUN_80057C00.c.o(.text);
        build/src/rock_neo/FUN_80057c20.c.o(.text);
        build/src/rock_neo/FUN_80057C80.c.o(.text);
        build/src/rock_neo/FUN_80057cbc.c.o(.text);
        build/src/rock_neo/FUN_80057D00.c.o(.text);
        build/src/rock_neo/FUN_80057D80.c.o(.text);
        build/src/rock_neo/FUN_80057E00.c.o(.text);
        build/src/rock_neo/FUN_80057E80.c.o(.text);
        build/src/rock_neo/FUN_80057F00.c.o(.text);
        build/src/rock_neo/FUN_80057f54.c.o(.text);
        build/src/rock_neo/FUN_80057F80.c.o(.text);
        build/src/rock_neo/FUN_80058000.c.o(.text);
        build/src/rock_neo/FUN_8005806c.c.o(.text);
        build/src/rock_neo/FUN_80058080.c.o(.text);
        build/src/rock_neo/FUN_80058100.c.o(.text);
        build/src/rock_neo/FUN_80058128.c.o(.text);
        build/src/rock_neo/FUN_8005816c.c.o(.text);
        build/src/rock_neo/FUN_80058180.c.o(.text);
        build/src/rock_neo/FUN_80058200.c.o(.text);
        build/src/rock_neo/FUN_80058280.c.o(.text);
        build/src/rock_neo/FUN_80058300.c.o(.text);
        build/src/rock_neo/FUN_80058380.c.o(.text);
        build/src/rock_neo/FUN_80058400.c.o(.text);
        build/src/rock_neo/FUN_80058480.c.o(.text);
        build/src/rock_neo/FUN_80058500.c.o(.text);
        build/asm/rock_neo/psxsdk/code.s.o(.text);
        build/src/rock_neo/FUN_8005f4e4.c.o(.text);
        build/src/rock_neo/FUN_8005f958.c.o(.text);
        build/src/rock_neo/FUN_8005fd50.c.o(.text);
        build/src/rock_neo/FUN_80066c34.c.o(.text);
        build/src/rock_neo/FUN_80066d5c.c.o(.text);
        build/src/rock_neo/FUN_80066dac.c.o(.text);
        build/src/rock_neo/FUN_80066e20.c.o(.text);
        build/src/rock_neo/FUN_80066e5c.c.o(.text);
        build/src/rock_neo/FUN_80066eac.c.o(.text);
        build/src/rock_neo/FUN_80066fb4.c.o(.text);
        build/src/rock_neo/FUN_80066fe4.c.o(.text);
        build/src/rock_neo/FUN_80067054.c.o(.text);
        build/src/rock_neo/FUN_800674a8.c.o(.text);
        build/src/rock_neo/FUN_80067590.c.o(.text);
        build/src/rock_neo/FUN_80067688.c.o(.text);
        build/src/rock_neo/FUN_80067724.c.o(.text);
        build/src/rock_neo/FUN_8006773c.c.o(.text);
        build/src/rock_neo/FUN_800678bc.c.o(.text);
        build/src/rock_neo/FUN_80067dec.c.o(.text);
        build/src/rock_neo/FUN_80067e34.c.o(.text);
        build/src/rock_neo/FUN_80067ee4.c.o(.text);
        build/src/rock_neo/FUN_80067fcc.c.o(.text);
        build/src/rock_neo/FUN_80068120.c.o(.text);
        build/src/rock_neo/FUN_80068438.c.o(.text);
        build/src/rock_neo/FUN_80068594.c.o(.text);
        build/src/rock_neo/FUN_800685b4.c.o(.text);
        build/src/rock_neo/FUN_80068868.c.o(.text);
        build/src/rock_neo/FUN_8006898c.c.o(.text);
        build/src/rock_neo/FUN_80068be4.c.o(.text);
        build/src/rock_neo/FUN_80068c50.c.o(.text);
        build/src/rock_neo/FUN_80068c94.c.o(.text);
        build/src/rock_neo/FUN_80068ec8.c.o(.text);
        build/src/rock_neo/FUN_80068fac.c.o(.text);
        build/src/rock_neo/FUN_80068fd4.c.o(.text);
        build/src/rock_neo/FUN_80069054.c.o(.text);
        build/src/rock_neo/FUN_800690e0.c.o(.text);
        build/src/rock_neo/FUN_8006916c.c.o(.text);
        build/src/rock_neo/FUN_800691f8.c.o(.text);
        build/src/rock_neo/FUN_80069284.c.o(.text);
        build/src/rock_neo/FUN_8006932c.c.o(.text);
        build/src/rock_neo/FUN_80069428.c.o(.text);
        build/src/rock_neo/FUN_800694ac.c.o(.text);
        build/src/rock_neo/FUN_800694f4.c.o(.text);
        build/src/rock_neo/FUN_80069780.c.o(.text);
        build/src/rock_neo/FUN_80069b00.c.o(.text);
        build/src/rock_neo/FUN_80069bb0.c.o(.text);
        build/src/rock_neo/FUN_80069c78.c.o(.text);
        build/src/rock_neo/FUN_80069d78.c.o(.text);
        build/src/rock_neo/FUN_80069e7c.c.o(.text);
        build/src/rock_neo/FUN_80069f44.c.o(.text);
        build/src/rock_neo/FUN_80069fb8.c.o(.text);
        build/src/rock_neo/FUN_8006a074.c.o(.text);
        build/src/rock_neo/FUN_8006a124.c.o(.text);
        build/src/rock_neo/FUN_8006a140.c.o(.text);
        build/src/rock_neo/FUN_8006a238.c.o(.text);
        build/src/rock_neo/FUN_8006a2b4.c.o(.text);
        build/src/rock_neo/FUN_8006a310.c.o(.text);
        build/src/rock_neo/FUN_8006a4b0.c.o(.text);
        build/src/rock_neo/FUN_8006a574.c.o(.text);
        build/src/rock_neo/FUN_8006a714.c.o(.text);
        build/src/rock_neo/FUN_8006a76c.c.o(.text);
        build/src/rock_neo/FUN_8006a7d4.c.o(.text);
        build/src/rock_neo/FUN_8006aab8.c.o(.text);
        build/src/rock_neo/FUN_8006ab10.c.o(.text);
        build/src/rock_neo/FUN_8006ab98.c.o(.text);
        build/src/rock_neo/FUN_8006abf0.c.o(.text);
        build/src/rock_neo/FUN_8006ade0.c.o(.text);
        build/src/rock_neo/FUN_8006ae48.c.o(.text);
        build/src/rock_neo/FUN_8006b0fc.c.o(.text);
        build/src/rock_neo/FUN_8006b130.c.o(.text);
        build/src/rock_neo/FUN_8006b7cc.c.o(.text);
        build/src/rock_neo/FUN_8006ba30.c.o(.text);
        build/src/rock_neo/FUN_8006bbac.c.o(.text);
        build/src/rock_neo/FUN_8006bbd0.c.o(.text);
        build/src/rock_neo/FUN_8006bbf4.c.o(.text);
        build/src/rock_neo/FUN_8006bcdc.c.o(.text);
        build/src/rock_neo/FUN_8006bd0c.c.o(.text);
        build/src/rock_neo/FUN_8006bdac.c.o(.text);
        build/src/rock_neo/FUN_8006c128.c.o(.text);
        build/src/rock_neo/FUN_8006c760.c.o(.text);
        build/src/rock_neo/FUN_8006c978.c.o(.text);
        build/src/rock_neo/FUN_8006cc4c.c.o(.text);
        build/src/rock_neo/FUN_8006ce08.c.o(.text);
        build/src/rock_neo/FUN_8006cec4.c.o(.text);
        build/src/rock_neo/FUN_8006cf54.c.o(.text);
        build/src/rock_neo/FUN_8006cfe4.c.o(.text);
        build/src/rock_neo/FUN_8006d194.c.o(.text);
        build/src/rock_neo/FUN_8006d24c.c.o(.text);
        build/src/rock_neo/FUN_8006d2fc.c.o(.text);
        build/src/rock_neo/FUN_8006d3ac.c.o(.text);
        build/src/rock_neo/FUN_8006d460.c.o(.text);
        build/src/rock_neo/FUN_8006d518.c.o(.text);
        build/src/rock_neo/FUN_8006d5cc.c.o(.text);
        build/src/rock_neo/FUN_8006d674.c.o(.text);
        build/src/rock_neo/FUN_8006d750.c.o(.text);
        build/src/rock_neo/FUN_8006d7f0.c.o(.text);
        build/src/rock_neo/FUN_8006d890.c.o(.text);
        build/src/rock_neo/FUN_8006d8b4.c.o(.text);
        build/src/rock_neo/FUN_8006d8dc.c.o(.text);
        build/src/rock_neo/FUN_8006d900.c.o(.text);
        build/src/rock_neo/FUN_8006d924.c.o(.text);
        build/src/rock_neo/FUN_8006d948.c.o(.text);
        build/src/rock_neo/FUN_8006de00.c.o(.text);
        build/src/rock_neo/FUN_8006ded4.c.o(.text);
        build/src/rock_neo/FUN_8006dff4.c.o(.text);
        build/src/rock_neo/FUN_8006e3dc.c.o(.text);
        build/src/rock_neo/FUN_8006e6fc.c.o(.text);
        build/src/rock_neo/FUN_8006ea48.c.o(.text);
        build/src/rock_neo/FUN_8006ea80.c.o(.text);
        build/src/rock_neo/FUN_8006eab8.c.o(.text);
        build/src/rock_neo/FUN_8006ebd4.c.o(.text);
        build/src/rock_neo/FUN_8006ec68.c.o(.text);
        build/src/rock_neo/FUN_8006effc.c.o(.text);
        build/src/rock_neo/FUN_8006f080.c.o(.text);
        build/src/rock_neo/FUN_8006f14c.c.o(.text);
        build/src/rock_neo/FUN_8006f3b4.c.o(.text);
        build/src/rock_neo/FUN_8006f3d4.c.o(.text);
        build/src/rock_neo/FUN_8006f3fc.c.o(.text);
        build/src/rock_neo/FUN_8006f43c.c.o(.text);
        build/src/rock_neo/FUN_8006f484.c.o(.text);
        build/src/rock_neo/FUN_8006f6f8.c.o(.text);
        build/src/rock_neo/FUN_8006fa18.c.o(.text);
        build/src/rock_neo/FUN_8006fdc4.c.o(.text);
        build/src/rock_neo/FUN_8006fe60.c.o(.text);
        build/src/rock_neo/FUN_8006fe8c.c.o(.text);
        build/src/rock_neo/FUN_8006ff94.c.o(.text);
        build/src/rock_neo/FUN_800701d8.c.o(.text);
        build/src/rock_neo/FUN_800706d8.c.o(.text);
        build/src/rock_neo/FUN_8007085c.c.o(.text);
        build/src/rock_neo/FUN_80070884.c.o(.text);
        build/src/rock_neo/FUN_800708b0.c.o(.text);
        build/src/rock_neo/FUN_800709ac.c.o(.text);
        build/src/rock_neo/FUN_80070b84.c.o(.text);
        build/src/rock_neo/FUN_80070cf0.c.o(.text);
        build/src/rock_neo/FUN_80070d7c.c.o(.text);
        build/src/rock_neo/FUN_80070ddc.c.o(.text);
        build/src/rock_neo/FUN_80070e68.c.o(.text);
        build/src/rock_neo/FUN_800710bc.c.o(.text);
        build/src/rock_neo/FUN_800711dc.c.o(.text);
        build/src/rock_neo/FUN_800712e4.c.o(.text);
        build/src/rock_neo/FUN_80071520.c.o(.text);
        build/src/rock_neo/FUN_800715d4.c.o(.text);
        build/src/rock_neo/FUN_80071968.c.o(.text);
        build/src/rock_neo/FUN_800719e0.c.o(.text);
        build/src/rock_neo/FUN_80071a20.c.o(.text);
        build/src/rock_neo/FUN_800724f4.c.o(.text);
        build/src/rock_neo/FUN_800726c4.c.o(.text);
        build/src/rock_neo/FUN_80072728.c.o(.text);
        build/src/rock_neo/FUN_800727dc.c.o(.text);
        build/src/rock_neo/FUN_800728ac.c.o(.text);
        build/src/rock_neo/FUN_800728ec.c.o(.text);
        build/src/rock_neo/FUN_8007290c.c.o(.text);
        build/src/rock_neo/FUN_8007292c.c.o(.text);
        build/src/rock_neo/FUN_80072af4.c.o(.text);
        build/src/rock_neo/FUN_80072d30.c.o(.text);
        build/src/rock_neo/FUN_80073164.c.o(.text);
        build/src/rock_neo/FUN_80073450.c.o(.text);
        build/src/rock_neo/FUN_80073490.c.o(.text);
        build/src/rock_neo/FUN_80073848.c.o(.text);
        build/src/rock_neo/FUN_80073dd4.c.o(.text);
        build/src/rock_neo/FUN_80073f18.c.o(.text);
        build/src/rock_neo/FUN_80074004.c.o(.text);
        build/src/rock_neo/FUN_80074040.c.o(.text);
        build/src/rock_neo/FUN_800749b8.c.o(.text);
        build/src/rock_neo/FUN_80074b58.c.o(.text);
        build/src/rock_neo/FUN_80074fac.c.o(.text);
        build/src/rock_neo/FUN_800751ac.c.o(.text);
        build/src/rock_neo/FUN_8007529c.c.o(.text);
        build/src/rock_neo/FUN_80075310.c.o(.text);
        build/src/rock_neo/FUN_80075364.c.o(.text);
        build/src/rock_neo/FUN_800753d8.c.o(.text);
        build/src/rock_neo/FUN_8007542c.c.o(.text);
        build/src/rock_neo/FUN_80075a64.c.o(.text);
        build/src/rock_neo/FUN_80075bac.c.o(.text);
        build/src/rock_neo/FUN_80076240.c.o(.text);
        build/src/rock_neo/FUN_800762c4.c.o(.text);
        build/src/rock_neo/FUN_80076648.c.o(.text);
        build/src/rock_neo/FUN_80076678.c.o(.text);
        build/src/rock_neo/FUN_800766a8.c.o(.text);
        build/src/rock_neo/FUN_800766d8.c.o(.text);
        build/src/rock_neo/FUN_80076abc.c.o(.text);
        build/src/rock_neo/FUN_80076d7c.c.o(.text);
        build/src/rock_neo/FUN_80076edc.c.o(.text);
        build/src/rock_neo/FUN_80076f68.c.o(.text);
        build/src/rock_neo/FUN_80076ff4.c.o(.text);
        build/src/rock_neo/FUN_80077024.c.o(.text);
        build/src/rock_neo/FUN_800770f4.c.o(.text);
        build/src/rock_neo/FUN_80077314.c.o(.text);
        build/src/rock_neo/FUN_800773b8.c.o(.text);
        build/src/rock_neo/FUN_800773e8.c.o(.text);
        build/src/rock_neo/FUN_80077418.c.o(.text);
        build/src/rock_neo/FUN_80077440.c.o(.text);
        build/src/rock_neo/FUN_8007747c.c.o(.text);
        build/src/rock_neo/FUN_800774ac.c.o(.text);
        build/src/rock_neo/FUN_800774dc.c.o(.text);
        build/src/rock_neo/FUN_80077548.c.o(.text);
        build/src/rock_neo/FUN_80077624.c.o(.text);
        build/src/rock_neo/FUN_8007780c.c.o(.text);
        build/src/rock_neo/FUN_80077960.c.o(.text);
        build/src/rock_neo/FUN_80077a0c.c.o(.text);
        build/src/rock_neo/FUN_80077a94.c.o(.text);
        build/src/rock_neo/FUN_80077ac0.c.o(.text);
        build/src/rock_neo/FUN_80077b20.c.o(.text);
        build/src/rock_neo/FUN_80077bbc.c.o(.text);
        build/src/rock_neo/FUN_80077be8.c.o(.text);
        build/src/rock_neo/FUN_80077c40.c.o(.text);
        build/src/rock_neo/FUN_80077e64.c.o(.text);
        build/src/rock_neo/FUN_80077eb8.c.o(.text);
        build/src/rock_neo/FUN_80077f50.c.o(.text);
        build/src/rock_neo/FUN_80077f78.c.o(.text);
        build/src/rock_neo/FUN_80077fa0.c.o(.text);
        build/src/rock_neo/FUN_80078008.c.o(.text);
        build/src/rock_neo/FUN_80078074.c.o(.text);
        build/src/rock_neo/FUN_80078114.c.o(.text);
        build/src/rock_neo/FUN_80078134.c.o(.text);
        build/src/rock_neo/FUN_80078184.c.o(.text);
        build/src/rock_neo/FUN_800782bc.c.o(.text);
        build/src/rock_neo/FUN_800783e8.c.o(.text);
        build/src/rock_neo/FUN_8007852c.c.o(.text);
        build/src/rock_neo/FUN_8007852c.c.o(.text);
        build/src/rock_neo/FUN_8007854c.c.o(.text);
        build/src/rock_neo/FUN_8007856c.c.o(.text);
        build/src/rock_neo/FUN_8007858c.c.o(.text);
        build/src/rock_neo/FUN_800785b0.c.o(.text);
        build/src/rock_neo/FUN_80078754.c.o(.text);
        build/src/rock_neo/FUN_80078cdc.c.o(.text);
        build/src/rock_neo/FUN_80078f5c.c.o(.text);
        build/src/rock_neo/FUN_80079230.c.o(.text);
        build/src/rock_neo/FUN_800797c4.c.o(.text);
        build/src/rock_neo/FUN_800798a0.c.o(.text);
        build/src/rock_neo/FUN_800798f0.c.o(.text);
        build/src/rock_neo/FUN_80079adc.c.o(.text);
        build/src/rock_neo/FUN_80079de4.c.o(.text);
        build/src/rock_neo/FUN_80079e50.c.o(.text);
        build/src/rock_neo/FUN_80079f2c.c.o(.text);
        build/src/rock_neo/FUN_8007a264.c.o(.text);
        build/src/rock_neo/FUN_8007a2f8.c.o(.text);
        build/src/rock_neo/FUN_8007a310.c.o(.text);
        build/src/rock_neo/FUN_8007a380.c.o(.text);
        build/src/rock_neo/FUN_8007a400.c.o(.text);
        build/src/rock_neo/FUN_8007a448.c.o(.text);
        build/src/rock_neo/FUN_8007a50c.c.o(.text);
        build/src/rock_neo/FUN_8007a588.c.o(.text);
        build/src/rock_neo/FUN_8007a5a8.c.o(.text);
        build/src/rock_neo/FUN_8007a5b4.c.o(.text);
        build/src/rock_neo/FUN_8007a5e0.c.o(.text);
        build/src/rock_neo/FUN_8007a648.c.o(.text);
        build/src/rock_neo/FUN_8007a66c.c.o(.text);
        build/src/rock_neo/FUN_8007a6ac.c.o(.text);
        build/src/rock_neo/FUN_8007a7a8.c.o(.text);
        build/src/rock_neo/FUN_8007a868.c.o(.text);
        build/src/rock_neo/FUN_8007a8fc.c.o(.text);
        build/src/rock_neo/FUN_8007a930.c.o(.text);
        build/src/rock_neo/FUN_8007a978.c.o(.text);
        build/src/rock_neo/FUN_8007aa3c.c.o(.text);
        build/src/rock_neo/FUN_8007ab5c.c.o(.text);
        build/src/rock_neo/FUN_8007adbc.c.o(.text);
        build/src/rock_neo/FUN_8007af04.c.o(.text);
        build/src/rock_neo/FUN_8007afcc.c.o(.text);
        build/src/rock_neo/FUN_8007b058.c.o(.text);
        build/src/rock_neo/FUN_8007b230.c.o(.text);
        build/src/rock_neo/FUN_8007b3ac.c.o(.text);
        build/src/rock_neo/FUN_8007b3d0.c.o(.text);
        build/src/rock_neo/FUN_8007b3f4.c.o(.text);
        build/src/rock_neo/FUN_8007b4dc.c.o(.text);
        build/src/rock_neo/FUN_8007b50c.c.o(.text);
        build/src/rock_neo/FUN_8007b56c.c.o(.text);
        build/src/rock_neo/FUN_8007b5ac.c.o(.text);
        build/src/rock_neo/FUN_8007b900.c.o(.text);
        build/src/rock_neo/FUN_8007bd60.c.o(.text);
        build/src/rock_neo/FUN_8007c0c0.c.o(.text);
        build/src/rock_neo/FUN_8007c224.c.o(.text);
        build/src/rock_neo/FUN_8007c3bc.c.o(.text);
        build/src/rock_neo/FUN_8007c3c8.c.o(.text);
        build/src/rock_neo/FUN_8007c6a0.c.o(.text);
        build/src/rock_neo/FUN_8007c898.c.o(.text);
        build/src/rock_neo/FUN_8007cacc.c.o(.text);
        build/src/rock_neo/FUN_8007cc14.c.o(.text);
        build/src/rock_neo/FUN_8007cc74.c.o(.text);
        build/src/rock_neo/FUN_8007d0f4.c.o(.text);
        build/asm/rock_neo/data/80064.sdata.s.o(.sdata);
        build/src/rock_neo/FUN_800800a0.c.o(.text);
        build/src/rock_neo/FUN_800800d4.c.o(.text);
        build/src/rock_neo/FUN_8008031c.c.o(.text);
        build/src/rock_neo/FUN_80080398.c.o(.text);
        build/src/rock_neo/FUN_800803d0.c.o(.text);
        build/src/rock_neo/FUN_80080428.c.o(.text);
        build/src/rock_neo/FUN_80080460.c.o(.text);
        build/asm/rock_neo/data/88958.scommon.s.o(.scommon);
        build/src/rock_neo/moji.c.o(.scommon);
        build/asm/rock_neo/data/89260.scommon.s.o(.scommon);
        build/src/rock_neo/FUN_80089fe4.c.o(.text);
        build/src/rock_neo/FUN_8008a060.c.o(.text);
        build/asm/rock_neo/565364.s.o(.text);
        build/src/rock_neo/FUN_8008a074.c.o(.text);
        build/src/rock_neo/FUN_8008a114.c.o(.text);
        build/src/rock_neo/FUN_8008a12c.c.o(.text);
        build/src/rock_neo/FUN_8008a178.c.o(.text);
        build/src/rock_neo/FUN_8008a1f0.c.o(.text);
        build/src/rock_neo/FUN_8008a23c.c.o(.text);
        build/src/rock_neo/FUN_8008a35c.c.o(.text);
        build/src/rock_neo/FUN_8008a438.c.o(.text);
        build/src/rock_neo/FUN_8008a4c0.c.o(.text);
        build/src/rock_neo/FUN_8008a5dc.c.o(.text);
        build/src/rock_neo/FUN_8008a5f0.c.o(.text);
        build/src/rock_neo/FUN_8008a64c.c.o(.text);
        build/src/rock_neo/FUN_8008a704.c.o(.text);
        build/src/rock_neo/FUN_8008a7f0.c.o(.text);
        build/src/rock_neo/FUN_8008a900.c.o(.text);
        build/src/rock_neo/FUN_8008aa60.c.o(.text);
        build/src/rock_neo/FUN_8008ac80.c.o(.text);
        build/src/rock_neo/FUN_8008acd0.c.o(.text);
        build/src/rock_neo/FUN_8008ad30.c.o(.text);
        build/src/rock_neo/FUN_8008ae60.c.o(.text);
        build/src/rock_neo/FUN_8008ae90.c.o(.text);
        build/src/rock_neo/FUN_8008aec0.c.o(.text);
        build/src/rock_neo/FUN_8008aef0.c.o(.text);
        build/src/rock_neo/FUN_8008b008.c.o(.text);
        build/src/rock_neo/FUN_8008b014.c.o(.text);
        build/src/rock_neo/FUN_8008b020.c.o(.text);
        build/src/rock_neo/FUN_8008b040.c.o(.text);
        build/src/rock_neo/FUN_8008b060.c.o(.text);
        build/src/rock_neo/FUN_8008b080.c.o(.text);
        build/src/rock_neo/FUN_8008b194.c.o(.text);
        build/src/rock_neo/FUN_8008b3b4.c.o(.text);
        build/src/rock_neo/FUN_8008b40c.c.o(.text);
        build/src/rock_neo/FUN_8008b480.c.o(.text);
        build/src/rock_neo/FUN_8008b4b0.c.o(.text);
        build/src/rock_neo/FUN_8008b4f0.c.o(.text);
        build/asm/rock_neo/data/8B648.bss.s.o(.bss);
        build/src/rock_neo/FUN_8008b780.c.o(.text);
        build/src/rock_neo/FUN_8008ba74.c.o(.text);
        build/src/rock_neo/FUN_8008bbb0.c.o(.text);
        build/src/rock_neo/FUN_8008bef0.c.o(.text);
        build/src/rock_neo/FUN_8008c070.c.o(.text);
        build/src/rock_neo/FUN_8008c2cc.c.o(.text);
        main_TEXT_END = .;
        main_TEXT_SIZE = ABSOLUTE(main_TEXT_END - main_TEXT_START);
        B5E88_bin = .;
        build/assets/rock_neo/B5E88.bin.o(.data);
        main_DATA_END = .;
        main_DATA_SIZE = ABSOLUTE(main_DATA_END - main_DATA_START);
    }
    __romPos += SIZEOF(.main);
    __romPos = ALIGN(__romPos, 16);
    main_ROM_END = __romPos;
    main_VRAM_END = .;

    /DISCARD/ :
    {
        *(*);
    }
}
