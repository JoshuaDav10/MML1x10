SECTIONS
{
    __romPos = 0;
    _gp = 0x0;
    ARM06R_PL00R06P_3_header_ROM_START = __romPos;
    ARM06R_PL00R06P_3_header_VRAM = ADDR(.ARM06R_PL00R06P_3_header);
    .ARM06R_PL00R06P_3_header : AT(ARM06R_PL00R06P_3_header_ROM_START) SUBALIGN(16)
    {
        ARM06R_PL00R06P_3_header_DATA_START = .;
        ARM06R_PL00R06P_3_header_s = .;
        build/asm/ARM06R/ovl3__PLBIN_PL00R06P.PBD/ARM06R_PL00R06P_3_header.s.o(.data);
        ARM06R_PL00R06P_3_header_DATA_END = .;
        ARM06R_PL00R06P_3_header_DATA_SIZE = ABSOLUTE(ARM06R_PL00R06P_3_header_DATA_END - ARM06R_PL00R06P_3_header_DATA_START);
    }
    __romPos += SIZEOF(.ARM06R_PL00R06P_3_header);
    ARM06R_PL00R06P_3_header_ROM_END = __romPos;
    ARM06R_PL00R06P_3_header_VRAM_END = .;

    ARM06R_PL00R06P_3_ROM_START = __romPos;
    ARM06R_PL00R06P_3_VRAM = ADDR(.ARM06R_PL00R06P_3);
    .ARM06R_PL00R06P_3 0x800FB500 : AT(ARM06R_PL00R06P_3_ROM_START) SUBALIGN(4)
    {
        ARM06R_PL00R06P_3_DATA_START = .;
        PL00R06P_3_data__s = .;
        build/asm/ARM06R/ovl3__PLBIN_PL00R06P.PBD/data/PL00R06P_3.data.s.o(.data);
        ARM06R_PL00R06P_3_DATA_END = .;
        ARM06R_PL00R06P_3_DATA_SIZE = ABSOLUTE(ARM06R_PL00R06P_3_DATA_END - ARM06R_PL00R06P_3_DATA_START);
    }
    __romPos += SIZEOF(.ARM06R_PL00R06P_3);
    __romPos = ALIGN(__romPos, 16);
    ARM06R_PL00R06P_3_ROM_END = __romPos;
    ARM06R_PL00R06P_3_VRAM_END = .;

    /DISCARD/ :
    {
        *(*);
    }
}
