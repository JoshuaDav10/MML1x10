SECTIONS
{
    __romPos = 0;
    _gp = 0x0;
    ST1A_02C_PL00DE1S_11_header_ROM_START = __romPos;
    ST1A_02C_PL00DE1S_11_header_VRAM = ADDR(.ST1A_02C_PL00DE1S_11_header);
    .ST1A_02C_PL00DE1S_11_header : AT(ST1A_02C_PL00DE1S_11_header_ROM_START) SUBALIGN(16)
    {
        ST1A_02C_PL00DE1S_11_header_DATA_START = .;
        ST1A_02C_PL00DE1S_11_header_s = .;
        build/asm/ST1A_02C/ovl11__PLBIN_PL00DE1S.PBD/ST1A_02C_PL00DE1S_11_header.s.o(.data);
        ST1A_02C_PL00DE1S_11_header_DATA_END = .;
        ST1A_02C_PL00DE1S_11_header_DATA_SIZE = ABSOLUTE(ST1A_02C_PL00DE1S_11_header_DATA_END - ST1A_02C_PL00DE1S_11_header_DATA_START);
    }
    __romPos += SIZEOF(.ST1A_02C_PL00DE1S_11_header);
    ST1A_02C_PL00DE1S_11_header_ROM_END = __romPos;
    ST1A_02C_PL00DE1S_11_header_VRAM_END = .;

    ST1A_02C_PL00DE1S_11_ROM_START = __romPos;
    ST1A_02C_PL00DE1S_11_VRAM = ADDR(.ST1A_02C_PL00DE1S_11);
    .ST1A_02C_PL00DE1S_11 0x800DBA00 : AT(ST1A_02C_PL00DE1S_11_ROM_START) SUBALIGN(4)
    {
        ST1A_02C_PL00DE1S_11_DATA_START = .;
        PL00DE1S_11_data__s = .;
        build/asm/ST1A_02C/ovl11__PLBIN_PL00DE1S.PBD/data/PL00DE1S_11.data.s.o(.data);
        ST1A_02C_PL00DE1S_11_DATA_END = .;
        ST1A_02C_PL00DE1S_11_DATA_SIZE = ABSOLUTE(ST1A_02C_PL00DE1S_11_DATA_END - ST1A_02C_PL00DE1S_11_DATA_START);
    }
    __romPos += SIZEOF(.ST1A_02C_PL00DE1S_11);
    __romPos = ALIGN(__romPos, 16);
    ST1A_02C_PL00DE1S_11_ROM_END = __romPos;
    ST1A_02C_PL00DE1S_11_VRAM_END = .;

    /DISCARD/ :
    {
        *(*);
    }
}
