SECTIONS
{
    __romPos = 0;
    _gp = 0x0;
    ARM01R_PL00R01S_1_header_ROM_START = __romPos;
    ARM01R_PL00R01S_1_header_VRAM = ADDR(.ARM01R_PL00R01S_1_header);
    .ARM01R_PL00R01S_1_header : AT(ARM01R_PL00R01S_1_header_ROM_START) SUBALIGN(16)
    {
        ARM01R_PL00R01S_1_header_DATA_START = .;
        ARM01R_PL00R01S_1_header_s = .;
        build/asm/ARM01R/ovl1__PLBIN_PL00R01S.PBD/ARM01R_PL00R01S_1_header.s.o(.data);
        ARM01R_PL00R01S_1_header_DATA_END = .;
        ARM01R_PL00R01S_1_header_DATA_SIZE = ABSOLUTE(ARM01R_PL00R01S_1_header_DATA_END - ARM01R_PL00R01S_1_header_DATA_START);
    }
    __romPos += SIZEOF(.ARM01R_PL00R01S_1_header);
    ARM01R_PL00R01S_1_header_ROM_END = __romPos;
    ARM01R_PL00R01S_1_header_VRAM_END = .;

    ARM01R_PL00R01S_1_ROM_START = __romPos;
    ARM01R_PL00R01S_1_VRAM = ADDR(.ARM01R_PL00R01S_1);
    .ARM01R_PL00R01S_1 0x800DC880 : AT(ARM01R_PL00R01S_1_ROM_START) SUBALIGN(4)
    {
        ARM01R_PL00R01S_1_DATA_START = .;
        PL00R01S_1_data__s = .;
        build/asm/ARM01R/ovl1__PLBIN_PL00R01S.PBD/data/PL00R01S_1.data.s.o(.data);
        ARM01R_PL00R01S_1_DATA_END = .;
        ARM01R_PL00R01S_1_DATA_SIZE = ABSOLUTE(ARM01R_PL00R01S_1_DATA_END - ARM01R_PL00R01S_1_DATA_START);
    }
    __romPos += SIZEOF(.ARM01R_PL00R01S_1);
    __romPos = ALIGN(__romPos, 16);
    ARM01R_PL00R01S_1_ROM_END = __romPos;
    ARM01R_PL00R01S_1_VRAM_END = .;

    /DISCARD/ :
    {
        *(*);
    }
}
