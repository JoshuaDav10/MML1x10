SECTIONS
{
    __romPos = 0;
    _gp = 0x0;
    ARM01R_PL00R01P_3_header_ROM_START = __romPos;
    ARM01R_PL00R01P_3_header_VRAM = ADDR(.ARM01R_PL00R01P_3_header);
    .ARM01R_PL00R01P_3_header : AT(ARM01R_PL00R01P_3_header_ROM_START) SUBALIGN(16)
    {
        ARM01R_PL00R01P_3_header_DATA_START = .;
        ARM01R_PL00R01P_3_header_s = .;
        build/asm/ARM01R/ovl3__PLBIN_PL00R01P.PBD/ARM01R_PL00R01P_3_header.s.o(.data);
        ARM01R_PL00R01P_3_header_DATA_END = .;
        ARM01R_PL00R01P_3_header_DATA_SIZE = ABSOLUTE(ARM01R_PL00R01P_3_header_DATA_END - ARM01R_PL00R01P_3_header_DATA_START);
    }
    __romPos += SIZEOF(.ARM01R_PL00R01P_3_header);
    ARM01R_PL00R01P_3_header_ROM_END = __romPos;
    ARM01R_PL00R01P_3_header_VRAM_END = .;

    ARM01R_PL00R01P_3_ROM_START = __romPos;
    ARM01R_PL00R01P_3_VRAM = ADDR(.ARM01R_PL00R01P_3);
    .ARM01R_PL00R01P_3 0x800FB500 : AT(ARM01R_PL00R01P_3_ROM_START) SUBALIGN(4)
    {
        ARM01R_PL00R01P_3_DATA_START = .;
        PL00R01P_3_data__s = .;
        build/asm/ARM01R/ovl3__PLBIN_PL00R01P.PBD/data/PL00R01P_3.data.s.o(.data);
        ARM01R_PL00R01P_3_DATA_END = .;
        ARM01R_PL00R01P_3_DATA_SIZE = ABSOLUTE(ARM01R_PL00R01P_3_DATA_END - ARM01R_PL00R01P_3_DATA_START);
    }
    __romPos += SIZEOF(.ARM01R_PL00R01P_3);
    __romPos = ALIGN(__romPos, 16);
    ARM01R_PL00R01P_3_ROM_END = __romPos;
    ARM01R_PL00R01P_3_VRAM_END = .;

    /DISCARD/ :
    {
        *(*);
    }
}
