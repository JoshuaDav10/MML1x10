SECTIONS
{
    __romPos = 0;
    _gp = 0x0;
    ARM10R_PL00R10S_1_header_ROM_START = __romPos;
    ARM10R_PL00R10S_1_header_VRAM = ADDR(.ARM10R_PL00R10S_1_header);
    .ARM10R_PL00R10S_1_header : AT(ARM10R_PL00R10S_1_header_ROM_START) SUBALIGN(16)
    {
        ARM10R_PL00R10S_1_header_DATA_START = .;
        ARM10R_PL00R10S_1_header_s = .;
        build/asm/ARM10R/ovl1__PLBIN_PL00R10S.PBD/ARM10R_PL00R10S_1_header.s.o(.data);
        ARM10R_PL00R10S_1_header_DATA_END = .;
        ARM10R_PL00R10S_1_header_DATA_SIZE = ABSOLUTE(ARM10R_PL00R10S_1_header_DATA_END - ARM10R_PL00R10S_1_header_DATA_START);
    }
    __romPos += SIZEOF(.ARM10R_PL00R10S_1_header);
    ARM10R_PL00R10S_1_header_ROM_END = __romPos;
    ARM10R_PL00R10S_1_header_VRAM_END = .;

    ARM10R_PL00R10S_1_ROM_START = __romPos;
    ARM10R_PL00R10S_1_VRAM = ADDR(.ARM10R_PL00R10S_1);
    .ARM10R_PL00R10S_1 0x800DC880 : AT(ARM10R_PL00R10S_1_ROM_START) SUBALIGN(4)
    {
        ARM10R_PL00R10S_1_DATA_START = .;
        PL00R10S_1_data__s = .;
        build/asm/ARM10R/ovl1__PLBIN_PL00R10S.PBD/data/PL00R10S_1.data.s.o(.data);
        ARM10R_PL00R10S_1_DATA_END = .;
        ARM10R_PL00R10S_1_DATA_SIZE = ABSOLUTE(ARM10R_PL00R10S_1_DATA_END - ARM10R_PL00R10S_1_DATA_START);
    }
    __romPos += SIZEOF(.ARM10R_PL00R10S_1);
    __romPos = ALIGN(__romPos, 16);
    ARM10R_PL00R10S_1_ROM_END = __romPos;
    ARM10R_PL00R10S_1_VRAM_END = .;

    /DISCARD/ :
    {
        *(*);
    }
}
