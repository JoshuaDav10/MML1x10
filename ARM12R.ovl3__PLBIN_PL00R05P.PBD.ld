SECTIONS
{
    __romPos = 0;
    _gp = 0x0;
    ARM12R_PL00R05P_3_header_ROM_START = __romPos;
    ARM12R_PL00R05P_3_header_VRAM = ADDR(.ARM12R_PL00R05P_3_header);
    .ARM12R_PL00R05P_3_header : AT(ARM12R_PL00R05P_3_header_ROM_START) SUBALIGN(16)
    {
        ARM12R_PL00R05P_3_header_DATA_START = .;
        ARM12R_PL00R05P_3_header_s = .;
        build/asm/ARM12R/ovl3__PLBIN_PL00R05P.PBD/ARM12R_PL00R05P_3_header.s.o(.data);
        ARM12R_PL00R05P_3_header_DATA_END = .;
        ARM12R_PL00R05P_3_header_DATA_SIZE = ABSOLUTE(ARM12R_PL00R05P_3_header_DATA_END - ARM12R_PL00R05P_3_header_DATA_START);
    }
    __romPos += SIZEOF(.ARM12R_PL00R05P_3_header);
    ARM12R_PL00R05P_3_header_ROM_END = __romPos;
    ARM12R_PL00R05P_3_header_VRAM_END = .;

    ARM12R_PL00R05P_3_ROM_START = __romPos;
    ARM12R_PL00R05P_3_VRAM = ADDR(.ARM12R_PL00R05P_3);
    .ARM12R_PL00R05P_3 0x800FB500 : AT(ARM12R_PL00R05P_3_ROM_START) SUBALIGN(4)
    {
        ARM12R_PL00R05P_3_DATA_START = .;
        PL00R05P_3_data__s = .;
        build/asm/ARM12R/ovl3__PLBIN_PL00R05P.PBD/data/PL00R05P_3.data.s.o(.data);
        ARM12R_PL00R05P_3_DATA_END = .;
        ARM12R_PL00R05P_3_DATA_SIZE = ABSOLUTE(ARM12R_PL00R05P_3_DATA_END - ARM12R_PL00R05P_3_DATA_START);
    }
    __romPos += SIZEOF(.ARM12R_PL00R05P_3);
    __romPos = ALIGN(__romPos, 16);
    ARM12R_PL00R05P_3_ROM_END = __romPos;
    ARM12R_PL00R05P_3_VRAM_END = .;

    /DISCARD/ :
    {
        *(*);
    }
}
