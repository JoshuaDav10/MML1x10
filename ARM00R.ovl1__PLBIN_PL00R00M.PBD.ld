SECTIONS
{
    __romPos = 0;
    _gp = 0x0;
    ARM00R_PL00R00M_1_header_ROM_START = __romPos;
    ARM00R_PL00R00M_1_header_VRAM = ADDR(.ARM00R_PL00R00M_1_header);
    .ARM00R_PL00R00M_1_header : AT(ARM00R_PL00R00M_1_header_ROM_START) SUBALIGN(16)
    {
        ARM00R_PL00R00M_1_header_DATA_START = .;
        ARM00R_PL00R00M_1_header_s = .;
        build/asm/ARM00R/ovl1__PLBIN_PL00R00M.PBD/ARM00R_PL00R00M_1_header.s.o(.data);
        ARM00R_PL00R00M_1_header_DATA_END = .;
        ARM00R_PL00R00M_1_header_DATA_SIZE = ABSOLUTE(ARM00R_PL00R00M_1_header_DATA_END - ARM00R_PL00R00M_1_header_DATA_START);
    }
    __romPos += SIZEOF(.ARM00R_PL00R00M_1_header);
    ARM00R_PL00R00M_1_header_ROM_END = __romPos;
    ARM00R_PL00R00M_1_header_VRAM_END = .;

    ARM00R_PL00R00M_1_ROM_START = __romPos;
    ARM00R_PL00R00M_1_VRAM = ADDR(.ARM00R_PL00R00M_1);
    .ARM00R_PL00R00M_1 0x800ED600 : AT(ARM00R_PL00R00M_1_ROM_START) SUBALIGN(4)
    {
        ARM00R_PL00R00M_1_DATA_START = .;
        PL00R00M_1_data__s = .;
        build/asm/ARM00R/ovl1__PLBIN_PL00R00M.PBD/data/PL00R00M_1.data.s.o(.data);
        ARM00R_PL00R00M_1_DATA_END = .;
        ARM00R_PL00R00M_1_DATA_SIZE = ABSOLUTE(ARM00R_PL00R00M_1_DATA_END - ARM00R_PL00R00M_1_DATA_START);
    }
    __romPos += SIZEOF(.ARM00R_PL00R00M_1);
    __romPos = ALIGN(__romPos, 16);
    ARM00R_PL00R00M_1_ROM_END = __romPos;
    ARM00R_PL00R00M_1_VRAM_END = .;

    /DISCARD/ :
    {
        *(*);
    }
}
