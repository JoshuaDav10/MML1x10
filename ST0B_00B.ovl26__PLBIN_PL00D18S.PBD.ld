SECTIONS
{
    __romPos = 0;
    _gp = 0x0;
    ST0B_00B_PL00D18S_26_header_ROM_START = __romPos;
    ST0B_00B_PL00D18S_26_header_VRAM = ADDR(.ST0B_00B_PL00D18S_26_header);
    .ST0B_00B_PL00D18S_26_header : AT(ST0B_00B_PL00D18S_26_header_ROM_START) SUBALIGN(16)
    {
        ST0B_00B_PL00D18S_26_header_DATA_START = .;
        ST0B_00B_PL00D18S_26_header_s = .;
        build/asm/ST0B_00B/ovl26__PLBIN_PL00D18S.PBD/ST0B_00B_PL00D18S_26_header.s.o(.data);
        ST0B_00B_PL00D18S_26_header_DATA_END = .;
        ST0B_00B_PL00D18S_26_header_DATA_SIZE = ABSOLUTE(ST0B_00B_PL00D18S_26_header_DATA_END - ST0B_00B_PL00D18S_26_header_DATA_START);
    }
    __romPos += SIZEOF(.ST0B_00B_PL00D18S_26_header);
    ST0B_00B_PL00D18S_26_header_ROM_END = __romPos;
    ST0B_00B_PL00D18S_26_header_VRAM_END = .;

    ST0B_00B_PL00D18S_26_ROM_START = __romPos;
    ST0B_00B_PL00D18S_26_VRAM = ADDR(.ST0B_00B_PL00D18S_26);
    .ST0B_00B_PL00D18S_26 0x800DBA00 : AT(ST0B_00B_PL00D18S_26_ROM_START) SUBALIGN(4)
    {
        ST0B_00B_PL00D18S_26_DATA_START = .;
        PL00D18S_26_data__s = .;
        build/asm/ST0B_00B/ovl26__PLBIN_PL00D18S.PBD/data/PL00D18S_26.data.s.o(.data);
        ST0B_00B_PL00D18S_26_DATA_END = .;
        ST0B_00B_PL00D18S_26_DATA_SIZE = ABSOLUTE(ST0B_00B_PL00D18S_26_DATA_END - ST0B_00B_PL00D18S_26_DATA_START);
    }
    __romPos += SIZEOF(.ST0B_00B_PL00D18S_26);
    __romPos = ALIGN(__romPos, 16);
    ST0B_00B_PL00D18S_26_ROM_END = __romPos;
    ST0B_00B_PL00D18S_26_VRAM_END = .;

    /DISCARD/ :
    {
        *(*);
    }
}
