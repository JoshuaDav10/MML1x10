SECTIONS
{
    __romPos = 0;
    _gp = 0x0;
    ARM08R_PL00R08P_3_header_ROM_START = __romPos;
    ARM08R_PL00R08P_3_header_VRAM = ADDR(.ARM08R_PL00R08P_3_header);
    .ARM08R_PL00R08P_3_header : AT(ARM08R_PL00R08P_3_header_ROM_START) SUBALIGN(16)
    {
        ARM08R_PL00R08P_3_header_DATA_START = .;
        ARM08R_PL00R08P_3_header_s = .;
        build/asm/ARM08R/ovl3__PLBIN_PL00R08P.PBD/ARM08R_PL00R08P_3_header.s.o(.data);
        ARM08R_PL00R08P_3_header_DATA_END = .;
        ARM08R_PL00R08P_3_header_DATA_SIZE = ABSOLUTE(ARM08R_PL00R08P_3_header_DATA_END - ARM08R_PL00R08P_3_header_DATA_START);
    }
    __romPos += SIZEOF(.ARM08R_PL00R08P_3_header);
    ARM08R_PL00R08P_3_header_ROM_END = __romPos;
    ARM08R_PL00R08P_3_header_VRAM_END = .;

    ARM08R_PL00R08P_3_ROM_START = __romPos;
    ARM08R_PL00R08P_3_VRAM = ADDR(.ARM08R_PL00R08P_3);
    .ARM08R_PL00R08P_3 0x800FB500 : AT(ARM08R_PL00R08P_3_ROM_START) SUBALIGN(4)
    {
        ARM08R_PL00R08P_3_DATA_START = .;
        PL00R08P_3_data__s = .;
        build/asm/ARM08R/ovl3__PLBIN_PL00R08P.PBD/data/PL00R08P_3.data.s.o(.data);
        ARM08R_PL00R08P_3_DATA_END = .;
        ARM08R_PL00R08P_3_DATA_SIZE = ABSOLUTE(ARM08R_PL00R08P_3_DATA_END - ARM08R_PL00R08P_3_DATA_START);
    }
    __romPos += SIZEOF(.ARM08R_PL00R08P_3);
    __romPos = ALIGN(__romPos, 16);
    ARM08R_PL00R08P_3_ROM_END = __romPos;
    ARM08R_PL00R08P_3_VRAM_END = .;

    /DISCARD/ :
    {
        *(*);
    }
}
