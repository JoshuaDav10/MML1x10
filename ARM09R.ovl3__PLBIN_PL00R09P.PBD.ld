SECTIONS
{
    __romPos = 0;
    _gp = 0x0;
    ARM09R_PL00R09P_3_header_ROM_START = __romPos;
    ARM09R_PL00R09P_3_header_VRAM = ADDR(.ARM09R_PL00R09P_3_header);
    .ARM09R_PL00R09P_3_header : AT(ARM09R_PL00R09P_3_header_ROM_START) SUBALIGN(16)
    {
        ARM09R_PL00R09P_3_header_DATA_START = .;
        ARM09R_PL00R09P_3_header_s = .;
        build/asm/ARM09R/ovl3__PLBIN_PL00R09P.PBD/ARM09R_PL00R09P_3_header.s.o(.data);
        ARM09R_PL00R09P_3_header_DATA_END = .;
        ARM09R_PL00R09P_3_header_DATA_SIZE = ABSOLUTE(ARM09R_PL00R09P_3_header_DATA_END - ARM09R_PL00R09P_3_header_DATA_START);
    }
    __romPos += SIZEOF(.ARM09R_PL00R09P_3_header);
    ARM09R_PL00R09P_3_header_ROM_END = __romPos;
    ARM09R_PL00R09P_3_header_VRAM_END = .;

    ARM09R_PL00R09P_3_ROM_START = __romPos;
    ARM09R_PL00R09P_3_VRAM = ADDR(.ARM09R_PL00R09P_3);
    .ARM09R_PL00R09P_3 0x800FB500 : AT(ARM09R_PL00R09P_3_ROM_START) SUBALIGN(4)
    {
        ARM09R_PL00R09P_3_DATA_START = .;
        PL00R09P_3_data__s = .;
        build/asm/ARM09R/ovl3__PLBIN_PL00R09P.PBD/data/PL00R09P_3.data.s.o(.data);
        ARM09R_PL00R09P_3_DATA_END = .;
        ARM09R_PL00R09P_3_DATA_SIZE = ABSOLUTE(ARM09R_PL00R09P_3_DATA_END - ARM09R_PL00R09P_3_DATA_START);
    }
    __romPos += SIZEOF(.ARM09R_PL00R09P_3);
    __romPos = ALIGN(__romPos, 16);
    ARM09R_PL00R09P_3_ROM_END = __romPos;
    ARM09R_PL00R09P_3_VRAM_END = .;

    /DISCARD/ :
    {
        *(*);
    }
}
