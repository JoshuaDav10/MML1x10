SECTIONS
{
    __romPos = 0;
    _gp = 0x0;
    ARM13R_PL00R05S_1_header_ROM_START = __romPos;
    ARM13R_PL00R05S_1_header_VRAM = ADDR(.ARM13R_PL00R05S_1_header);
    .ARM13R_PL00R05S_1_header : AT(ARM13R_PL00R05S_1_header_ROM_START) SUBALIGN(16)
    {
        ARM13R_PL00R05S_1_header_DATA_START = .;
        ARM13R_PL00R05S_1_header_s = .;
        build/asm/ARM13R/ovl1__PLBIN_PL00R05S.PBD/ARM13R_PL00R05S_1_header.s.o(.data);
        ARM13R_PL00R05S_1_header_DATA_END = .;
        ARM13R_PL00R05S_1_header_DATA_SIZE = ABSOLUTE(ARM13R_PL00R05S_1_header_DATA_END - ARM13R_PL00R05S_1_header_DATA_START);
    }
    __romPos += SIZEOF(.ARM13R_PL00R05S_1_header);
    ARM13R_PL00R05S_1_header_ROM_END = __romPos;
    ARM13R_PL00R05S_1_header_VRAM_END = .;

    ARM13R_PL00R05S_1_ROM_START = __romPos;
    ARM13R_PL00R05S_1_VRAM = ADDR(.ARM13R_PL00R05S_1);
    .ARM13R_PL00R05S_1 0x800DC880 : AT(ARM13R_PL00R05S_1_ROM_START) SUBALIGN(4)
    {
        ARM13R_PL00R05S_1_DATA_START = .;
        PL00R05S_1_data__s = .;
        build/asm/ARM13R/ovl1__PLBIN_PL00R05S.PBD/data/PL00R05S_1.data.s.o(.data);
        ARM13R_PL00R05S_1_DATA_END = .;
        ARM13R_PL00R05S_1_DATA_SIZE = ABSOLUTE(ARM13R_PL00R05S_1_DATA_END - ARM13R_PL00R05S_1_DATA_START);
    }
    __romPos += SIZEOF(.ARM13R_PL00R05S_1);
    __romPos = ALIGN(__romPos, 16);
    ARM13R_PL00R05S_1_ROM_END = __romPos;
    ARM13R_PL00R05S_1_VRAM_END = .;

    /DISCARD/ :
    {
        *(*);
    }
}
