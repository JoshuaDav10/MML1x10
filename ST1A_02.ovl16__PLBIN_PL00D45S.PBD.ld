SECTIONS
{
    __romPos = 0;
    _gp = 0x0;
    ST1A_02_PL00D45S_16_header_ROM_START = __romPos;
    ST1A_02_PL00D45S_16_header_VRAM = ADDR(.ST1A_02_PL00D45S_16_header);
    .ST1A_02_PL00D45S_16_header : AT(ST1A_02_PL00D45S_16_header_ROM_START) SUBALIGN(16)
    {
        ST1A_02_PL00D45S_16_header_DATA_START = .;
        ST1A_02_PL00D45S_16_header_s = .;
        build/asm/ST1A_02/ovl16__PLBIN_PL00D45S.PBD/ST1A_02_PL00D45S_16_header.s.o(.data);
        ST1A_02_PL00D45S_16_header_DATA_END = .;
        ST1A_02_PL00D45S_16_header_DATA_SIZE = ABSOLUTE(ST1A_02_PL00D45S_16_header_DATA_END - ST1A_02_PL00D45S_16_header_DATA_START);
    }
    __romPos += SIZEOF(.ST1A_02_PL00D45S_16_header);
    ST1A_02_PL00D45S_16_header_ROM_END = __romPos;
    ST1A_02_PL00D45S_16_header_VRAM_END = .;

    ST1A_02_PL00D45S_16_ROM_START = __romPos;
    ST1A_02_PL00D45S_16_VRAM = ADDR(.ST1A_02_PL00D45S_16);
    .ST1A_02_PL00D45S_16 0x800DBA00 : AT(ST1A_02_PL00D45S_16_ROM_START) SUBALIGN(4)
    {
        ST1A_02_PL00D45S_16_DATA_START = .;
        PL00D45S_16_data__s = .;
        build/asm/ST1A_02/ovl16__PLBIN_PL00D45S.PBD/data/PL00D45S_16.data.s.o(.data);
        ST1A_02_PL00D45S_16_DATA_END = .;
        ST1A_02_PL00D45S_16_DATA_SIZE = ABSOLUTE(ST1A_02_PL00D45S_16_DATA_END - ST1A_02_PL00D45S_16_DATA_START);
    }
    __romPos += SIZEOF(.ST1A_02_PL00D45S_16);
    __romPos = ALIGN(__romPos, 16);
    ST1A_02_PL00D45S_16_ROM_END = __romPos;
    ST1A_02_PL00D45S_16_VRAM_END = .;

    /DISCARD/ :
    {
        *(*);
    }
}
