SECTIONS
{
    __romPos = 0;
    _gp = 0x0;
    ST0A_00_PL00D15M_23_header_ROM_START = __romPos;
    ST0A_00_PL00D15M_23_header_VRAM = ADDR(.ST0A_00_PL00D15M_23_header);
    .ST0A_00_PL00D15M_23_header : AT(ST0A_00_PL00D15M_23_header_ROM_START) SUBALIGN(16)
    {
        ST0A_00_PL00D15M_23_header_DATA_START = .;
        ST0A_00_PL00D15M_23_header_s = .;
        build/asm/ST0A_00/ovl23__PLBIN_PL00D15M.PBD/ST0A_00_PL00D15M_23_header.s.o(.data);
        ST0A_00_PL00D15M_23_header_DATA_END = .;
        ST0A_00_PL00D15M_23_header_DATA_SIZE = ABSOLUTE(ST0A_00_PL00D15M_23_header_DATA_END - ST0A_00_PL00D15M_23_header_DATA_START);
    }
    __romPos += SIZEOF(.ST0A_00_PL00D15M_23_header);
    ST0A_00_PL00D15M_23_header_ROM_END = __romPos;
    ST0A_00_PL00D15M_23_header_VRAM_END = .;

    ST0A_00_PL00D15M_23_ROM_START = __romPos;
    ST0A_00_PL00D15M_23_VRAM = ADDR(.ST0A_00_PL00D15M_23);
    .ST0A_00_PL00D15M_23 0x800E9600 : AT(ST0A_00_PL00D15M_23_ROM_START) SUBALIGN(4)
    {
        ST0A_00_PL00D15M_23_DATA_START = .;
        PL00D15M_23_data__s = .;
        build/asm/ST0A_00/ovl23__PLBIN_PL00D15M.PBD/data/PL00D15M_23.data.s.o(.data);
        ST0A_00_PL00D15M_23_DATA_END = .;
        ST0A_00_PL00D15M_23_DATA_SIZE = ABSOLUTE(ST0A_00_PL00D15M_23_DATA_END - ST0A_00_PL00D15M_23_DATA_START);
    }
    __romPos += SIZEOF(.ST0A_00_PL00D15M_23);
    __romPos = ALIGN(__romPos, 16);
    ST0A_00_PL00D15M_23_ROM_END = __romPos;
    ST0A_00_PL00D15M_23_VRAM_END = .;

    /DISCARD/ :
    {
        *(*);
    }
}
