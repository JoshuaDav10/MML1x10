SECTIONS
{
    __romPos = 0;
    _gp = 0x0;
    ARM07R_PL00R07S_1_header_ROM_START = __romPos;
    ARM07R_PL00R07S_1_header_VRAM = ADDR(.ARM07R_PL00R07S_1_header);
    .ARM07R_PL00R07S_1_header : AT(ARM07R_PL00R07S_1_header_ROM_START) SUBALIGN(16)
    {
        ARM07R_PL00R07S_1_header_DATA_START = .;
        ARM07R_PL00R07S_1_header_s = .;
        build/asm/ARM07R/ovl1__PLBIN_PL00R07S.PBD/ARM07R_PL00R07S_1_header.s.o(.data);
        ARM07R_PL00R07S_1_header_DATA_END = .;
        ARM07R_PL00R07S_1_header_DATA_SIZE = ABSOLUTE(ARM07R_PL00R07S_1_header_DATA_END - ARM07R_PL00R07S_1_header_DATA_START);
    }
    __romPos += SIZEOF(.ARM07R_PL00R07S_1_header);
    ARM07R_PL00R07S_1_header_ROM_END = __romPos;
    ARM07R_PL00R07S_1_header_VRAM_END = .;

    ARM07R_PL00R07S_1_ROM_START = __romPos;
    ARM07R_PL00R07S_1_VRAM = ADDR(.ARM07R_PL00R07S_1);
    .ARM07R_PL00R07S_1 0x800DC880 : AT(ARM07R_PL00R07S_1_ROM_START) SUBALIGN(4)
    {
        ARM07R_PL00R07S_1_DATA_START = .;
        PL00R07S_1_data__s = .;
        build/asm/ARM07R/ovl1__PLBIN_PL00R07S.PBD/data/PL00R07S_1.data.s.o(.data);
        ARM07R_PL00R07S_1_DATA_END = .;
        ARM07R_PL00R07S_1_DATA_SIZE = ABSOLUTE(ARM07R_PL00R07S_1_DATA_END - ARM07R_PL00R07S_1_DATA_START);
    }
    __romPos += SIZEOF(.ARM07R_PL00R07S_1);
    __romPos = ALIGN(__romPos, 16);
    ARM07R_PL00R07S_1_ROM_END = __romPos;
    ARM07R_PL00R07S_1_VRAM_END = .;

    /DISCARD/ :
    {
        *(*);
    }
}
