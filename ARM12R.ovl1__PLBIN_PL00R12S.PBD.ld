SECTIONS
{
    __romPos = 0;
    _gp = 0x0;
    ARM12R_PL00R12S_1_header_ROM_START = __romPos;
    ARM12R_PL00R12S_1_header_VRAM = ADDR(.ARM12R_PL00R12S_1_header);
    .ARM12R_PL00R12S_1_header : AT(ARM12R_PL00R12S_1_header_ROM_START) SUBALIGN(16)
    {
        ARM12R_PL00R12S_1_header_DATA_START = .;
        ARM12R_PL00R12S_1_header_s = .;
        build/asm/ARM12R/ovl1__PLBIN_PL00R12S.PBD/ARM12R_PL00R12S_1_header.s.o(.data);
        ARM12R_PL00R12S_1_header_DATA_END = .;
        ARM12R_PL00R12S_1_header_DATA_SIZE = ABSOLUTE(ARM12R_PL00R12S_1_header_DATA_END - ARM12R_PL00R12S_1_header_DATA_START);
    }
    __romPos += SIZEOF(.ARM12R_PL00R12S_1_header);
    ARM12R_PL00R12S_1_header_ROM_END = __romPos;
    ARM12R_PL00R12S_1_header_VRAM_END = .;

    ARM12R_PL00R12S_1_ROM_START = __romPos;
    ARM12R_PL00R12S_1_VRAM = ADDR(.ARM12R_PL00R12S_1);
    .ARM12R_PL00R12S_1 0x800DC880 : AT(ARM12R_PL00R12S_1_ROM_START) SUBALIGN(4)
    {
        ARM12R_PL00R12S_1_DATA_START = .;
        PL00R12S_1_data__s = .;
        build/asm/ARM12R/ovl1__PLBIN_PL00R12S.PBD/data/PL00R12S_1.data.s.o(.data);
        ARM12R_PL00R12S_1_DATA_END = .;
        ARM12R_PL00R12S_1_DATA_SIZE = ABSOLUTE(ARM12R_PL00R12S_1_DATA_END - ARM12R_PL00R12S_1_DATA_START);
    }
    __romPos += SIZEOF(.ARM12R_PL00R12S_1);
    __romPos = ALIGN(__romPos, 16);
    ARM12R_PL00R12S_1_ROM_END = __romPos;
    ARM12R_PL00R12S_1_VRAM_END = .;

    /DISCARD/ :
    {
        *(*);
    }
}
