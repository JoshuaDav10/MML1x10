SECTIONS
{
    __romPos = 0;
    _gp = 0x0;
    ST1A_02D_PL00DE2M_7_header_ROM_START = __romPos;
    ST1A_02D_PL00DE2M_7_header_VRAM = ADDR(.ST1A_02D_PL00DE2M_7_header);
    .ST1A_02D_PL00DE2M_7_header : AT(ST1A_02D_PL00DE2M_7_header_ROM_START) SUBALIGN(16)
    {
        ST1A_02D_PL00DE2M_7_header_DATA_START = .;
        ST1A_02D_PL00DE2M_7_header_s = .;
        build/asm/ST1A_02D/ovl7__PLBIN_PL00DE2M.PBD/ST1A_02D_PL00DE2M_7_header.s.o(.data);
        ST1A_02D_PL00DE2M_7_header_DATA_END = .;
        ST1A_02D_PL00DE2M_7_header_DATA_SIZE = ABSOLUTE(ST1A_02D_PL00DE2M_7_header_DATA_END - ST1A_02D_PL00DE2M_7_header_DATA_START);
    }
    __romPos += SIZEOF(.ST1A_02D_PL00DE2M_7_header);
    ST1A_02D_PL00DE2M_7_header_ROM_END = __romPos;
    ST1A_02D_PL00DE2M_7_header_VRAM_END = .;

    ST1A_02D_PL00DE2M_7_ROM_START = __romPos;
    ST1A_02D_PL00DE2M_7_VRAM = ADDR(.ST1A_02D_PL00DE2M_7);
    .ST1A_02D_PL00DE2M_7 0x800E9600 : AT(ST1A_02D_PL00DE2M_7_ROM_START) SUBALIGN(4)
    {
        ST1A_02D_PL00DE2M_7_DATA_START = .;
        PL00DE2M_7_data__s = .;
        build/asm/ST1A_02D/ovl7__PLBIN_PL00DE2M.PBD/data/PL00DE2M_7.data.s.o(.data);
        ST1A_02D_PL00DE2M_7_DATA_END = .;
        ST1A_02D_PL00DE2M_7_DATA_SIZE = ABSOLUTE(ST1A_02D_PL00DE2M_7_DATA_END - ST1A_02D_PL00DE2M_7_DATA_START);
    }
    __romPos += SIZEOF(.ST1A_02D_PL00DE2M_7);
    __romPos = ALIGN(__romPos, 16);
    ST1A_02D_PL00DE2M_7_ROM_END = __romPos;
    ST1A_02D_PL00DE2M_7_VRAM_END = .;

    /DISCARD/ :
    {
        *(*);
    }
}
