SECTIONS
{
    __romPos = 0;
    _gp = 0x0;
    ARM00L_PL00L00S_0_header_ROM_START = __romPos;
    ARM00L_PL00L00S_0_header_VRAM = ADDR(.ARM00L_PL00L00S_0_header);
    .ARM00L_PL00L00S_0_header : AT(ARM00L_PL00L00S_0_header_ROM_START) SUBALIGN(16)
    {
        ARM00L_PL00L00S_0_header_DATA_START = .;
        ARM00L_PL00L00S_0_header_s = .;
        build/asm/ARM00L/ovl0__PLBIN_PL00L00S.PBD/ARM00L_PL00L00S_0_header.s.o(.data);
        ARM00L_PL00L00S_0_header_DATA_END = .;
        ARM00L_PL00L00S_0_header_DATA_SIZE = ABSOLUTE(ARM00L_PL00L00S_0_header_DATA_END - ARM00L_PL00L00S_0_header_DATA_START);
    }
    __romPos += SIZEOF(.ARM00L_PL00L00S_0_header);
    ARM00L_PL00L00S_0_header_ROM_END = __romPos;
    ARM00L_PL00L00S_0_header_VRAM_END = .;

    ARM00L_PL00L00S_0_ROM_START = __romPos;
    ARM00L_PL00L00S_0_VRAM = ADDR(.ARM00L_PL00L00S_0);
    .ARM00L_PL00L00S_0 0x800DCD00 : AT(ARM00L_PL00L00S_0_ROM_START) SUBALIGN(4)
    {
        ARM00L_PL00L00S_0_DATA_START = .;
        PL00L00S_0_data__s = .;
        build/asm/ARM00L/ovl0__PLBIN_PL00L00S.PBD/data/PL00L00S_0.data.s.o(.data);
        ARM00L_PL00L00S_0_DATA_END = .;
        ARM00L_PL00L00S_0_DATA_SIZE = ABSOLUTE(ARM00L_PL00L00S_0_DATA_END - ARM00L_PL00L00S_0_DATA_START);
    }
    __romPos += SIZEOF(.ARM00L_PL00L00S_0);
    __romPos = ALIGN(__romPos, 16);
    ARM00L_PL00L00S_0_ROM_END = __romPos;
    ARM00L_PL00L00S_0_VRAM_END = .;

    /DISCARD/ :
    {
        *(*);
    }
}
