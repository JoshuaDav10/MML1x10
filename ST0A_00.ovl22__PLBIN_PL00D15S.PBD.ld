SECTIONS
{
    __romPos = 0;
    _gp = 0x0;
    ST0A_00_PL00D15S_22_header_ROM_START = __romPos;
    ST0A_00_PL00D15S_22_header_VRAM = ADDR(.ST0A_00_PL00D15S_22_header);
    .ST0A_00_PL00D15S_22_header : AT(ST0A_00_PL00D15S_22_header_ROM_START) SUBALIGN(16)
    {
        ST0A_00_PL00D15S_22_header_DATA_START = .;
        ST0A_00_PL00D15S_22_header_s = .;
        build/asm/ST0A_00/ovl22__PLBIN_PL00D15S.PBD/ST0A_00_PL00D15S_22_header.s.o(.data);
        ST0A_00_PL00D15S_22_header_DATA_END = .;
        ST0A_00_PL00D15S_22_header_DATA_SIZE = ABSOLUTE(ST0A_00_PL00D15S_22_header_DATA_END - ST0A_00_PL00D15S_22_header_DATA_START);
    }
    __romPos += SIZEOF(.ST0A_00_PL00D15S_22_header);
    ST0A_00_PL00D15S_22_header_ROM_END = __romPos;
    ST0A_00_PL00D15S_22_header_VRAM_END = .;

    ST0A_00_PL00D15S_22_ROM_START = __romPos;
    ST0A_00_PL00D15S_22_VRAM = ADDR(.ST0A_00_PL00D15S_22);
    .ST0A_00_PL00D15S_22 0x800DBA00 : AT(ST0A_00_PL00D15S_22_ROM_START) SUBALIGN(4)
    {
        ST0A_00_PL00D15S_22_DATA_START = .;
        PL00D15S_22_data__s = .;
        build/asm/ST0A_00/ovl22__PLBIN_PL00D15S.PBD/data/PL00D15S_22.data.s.o(.data);
        ST0A_00_PL00D15S_22_DATA_END = .;
        ST0A_00_PL00D15S_22_DATA_SIZE = ABSOLUTE(ST0A_00_PL00D15S_22_DATA_END - ST0A_00_PL00D15S_22_DATA_START);
    }
    __romPos += SIZEOF(.ST0A_00_PL00D15S_22);
    __romPos = ALIGN(__romPos, 16);
    ST0A_00_PL00D15S_22_ROM_END = __romPos;
    ST0A_00_PL00D15S_22_VRAM_END = .;

    /DISCARD/ :
    {
        *(*);
    }
}
