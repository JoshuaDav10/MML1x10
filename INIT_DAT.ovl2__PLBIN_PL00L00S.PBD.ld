SECTIONS
{
    __romPos = 0;
    _gp = 0x0;
    INIT_DAT_PL00L00S_2_header_ROM_START = __romPos;
    INIT_DAT_PL00L00S_2_header_VRAM = ADDR(.INIT_DAT_PL00L00S_2_header);
    .INIT_DAT_PL00L00S_2_header : AT(INIT_DAT_PL00L00S_2_header_ROM_START) SUBALIGN(16)
    {
        INIT_DAT_PL00L00S_2_header_DATA_START = .;
        INIT_DAT_PL00L00S_2_header_s = .;
        build/asm/INIT_DAT/ovl2__PLBIN_PL00L00S.PBD/INIT_DAT_PL00L00S_2_header.s.o(.data);
        INIT_DAT_PL00L00S_2_header_DATA_END = .;
        INIT_DAT_PL00L00S_2_header_DATA_SIZE = ABSOLUTE(INIT_DAT_PL00L00S_2_header_DATA_END - INIT_DAT_PL00L00S_2_header_DATA_START);
    }
    __romPos += SIZEOF(.INIT_DAT_PL00L00S_2_header);
    INIT_DAT_PL00L00S_2_header_ROM_END = __romPos;
    INIT_DAT_PL00L00S_2_header_VRAM_END = .;

    INIT_DAT_PL00L00S_2_ROM_START = __romPos;
    INIT_DAT_PL00L00S_2_VRAM = ADDR(.INIT_DAT_PL00L00S_2);
    .INIT_DAT_PL00L00S_2 0x800DCD00 : AT(INIT_DAT_PL00L00S_2_ROM_START) SUBALIGN(4)
    {
        INIT_DAT_PL00L00S_2_DATA_START = .;
        PL00L00S_2_data__s = .;
        build/asm/INIT_DAT/ovl2__PLBIN_PL00L00S.PBD/data/PL00L00S_2.data.s.o(.data);
        INIT_DAT_PL00L00S_2_DATA_END = .;
        INIT_DAT_PL00L00S_2_DATA_SIZE = ABSOLUTE(INIT_DAT_PL00L00S_2_DATA_END - INIT_DAT_PL00L00S_2_DATA_START);
    }
    __romPos += SIZEOF(.INIT_DAT_PL00L00S_2);
    __romPos = ALIGN(__romPos, 16);
    INIT_DAT_PL00L00S_2_ROM_END = __romPos;
    INIT_DAT_PL00L00S_2_VRAM_END = .;

    /DISCARD/ :
    {
        *(*);
    }
}
