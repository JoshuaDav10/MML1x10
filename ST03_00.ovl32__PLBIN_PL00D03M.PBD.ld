SECTIONS
{
    __romPos = 0;
    _gp = 0x0;
    ST03_00_PL00D03M_32_header_ROM_START = __romPos;
    ST03_00_PL00D03M_32_header_VRAM = ADDR(.ST03_00_PL00D03M_32_header);
    .ST03_00_PL00D03M_32_header : AT(ST03_00_PL00D03M_32_header_ROM_START) SUBALIGN(16)
    {
        ST03_00_PL00D03M_32_header_DATA_START = .;
        ST03_00_PL00D03M_32_header_s = .;
        build/asm/ST03_00/ovl32__PLBIN_PL00D03M.PBD/ST03_00_PL00D03M_32_header.s.o(.data);
        ST03_00_PL00D03M_32_header_DATA_END = .;
        ST03_00_PL00D03M_32_header_DATA_SIZE = ABSOLUTE(ST03_00_PL00D03M_32_header_DATA_END - ST03_00_PL00D03M_32_header_DATA_START);
    }
    __romPos += SIZEOF(.ST03_00_PL00D03M_32_header);
    ST03_00_PL00D03M_32_header_ROM_END = __romPos;
    ST03_00_PL00D03M_32_header_VRAM_END = .;

    ST03_00_PL00D03M_32_ROM_START = __romPos;
    ST03_00_PL00D03M_32_VRAM = ADDR(.ST03_00_PL00D03M_32);
    .ST03_00_PL00D03M_32 0x800E9600 : AT(ST03_00_PL00D03M_32_ROM_START) SUBALIGN(4)
    {
        ST03_00_PL00D03M_32_DATA_START = .;
        PL00D03M_32_data__s = .;
        build/asm/ST03_00/ovl32__PLBIN_PL00D03M.PBD/data/PL00D03M_32.data.s.o(.data);
        ST03_00_PL00D03M_32_DATA_END = .;
        ST03_00_PL00D03M_32_DATA_SIZE = ABSOLUTE(ST03_00_PL00D03M_32_DATA_END - ST03_00_PL00D03M_32_DATA_START);
    }
    __romPos += SIZEOF(.ST03_00_PL00D03M_32);
    __romPos = ALIGN(__romPos, 16);
    ST03_00_PL00D03M_32_ROM_END = __romPos;
    ST03_00_PL00D03M_32_VRAM_END = .;

    /DISCARD/ :
    {
        *(*);
    }
}
