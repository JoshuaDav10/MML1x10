SECTIONS
{
    __romPos = 0;
    _gp = 0x0;
    ST13_00_PL00D33M_29_header_ROM_START = __romPos;
    ST13_00_PL00D33M_29_header_VRAM = ADDR(.ST13_00_PL00D33M_29_header);
    .ST13_00_PL00D33M_29_header : AT(ST13_00_PL00D33M_29_header_ROM_START) SUBALIGN(16)
    {
        ST13_00_PL00D33M_29_header_DATA_START = .;
        ST13_00_PL00D33M_29_header_s = .;
        build/asm/ST13_00/ovl29__PLBIN_PL00D33M.PBD/ST13_00_PL00D33M_29_header.s.o(.data);
        ST13_00_PL00D33M_29_header_DATA_END = .;
        ST13_00_PL00D33M_29_header_DATA_SIZE = ABSOLUTE(ST13_00_PL00D33M_29_header_DATA_END - ST13_00_PL00D33M_29_header_DATA_START);
    }
    __romPos += SIZEOF(.ST13_00_PL00D33M_29_header);
    ST13_00_PL00D33M_29_header_ROM_END = __romPos;
    ST13_00_PL00D33M_29_header_VRAM_END = .;

    ST13_00_PL00D33M_29_ROM_START = __romPos;
    ST13_00_PL00D33M_29_VRAM = ADDR(.ST13_00_PL00D33M_29);
    .ST13_00_PL00D33M_29 0x800E9600 : AT(ST13_00_PL00D33M_29_ROM_START) SUBALIGN(4)
    {
        ST13_00_PL00D33M_29_DATA_START = .;
        PL00D33M_29_data__s = .;
        build/asm/ST13_00/ovl29__PLBIN_PL00D33M.PBD/data/PL00D33M_29.data.s.o(.data);
        ST13_00_PL00D33M_29_DATA_END = .;
        ST13_00_PL00D33M_29_DATA_SIZE = ABSOLUTE(ST13_00_PL00D33M_29_DATA_END - ST13_00_PL00D33M_29_DATA_START);
    }
    __romPos += SIZEOF(.ST13_00_PL00D33M_29);
    __romPos = ALIGN(__romPos, 16);
    ST13_00_PL00D33M_29_ROM_END = __romPos;
    ST13_00_PL00D33M_29_VRAM_END = .;

    /DISCARD/ :
    {
        *(*);
    }
}
