SECTIONS
{
    __romPos = 0;
    _gp = 0x0;
    ST06_02_PL00S06S_42_header_ROM_START = __romPos;
    ST06_02_PL00S06S_42_header_VRAM = ADDR(.ST06_02_PL00S06S_42_header);
    .ST06_02_PL00S06S_42_header : AT(ST06_02_PL00S06S_42_header_ROM_START) SUBALIGN(16)
    {
        ST06_02_PL00S06S_42_header_DATA_START = .;
        ST06_02_PL00S06S_42_header_s = .;
        build/asm/ST06_02/ovl42__PLBIN_PL00S06S.PBD/ST06_02_PL00S06S_42_header.s.o(.data);
        ST06_02_PL00S06S_42_header_DATA_END = .;
        ST06_02_PL00S06S_42_header_DATA_SIZE = ABSOLUTE(ST06_02_PL00S06S_42_header_DATA_END - ST06_02_PL00S06S_42_header_DATA_START);
    }
    __romPos += SIZEOF(.ST06_02_PL00S06S_42_header);
    ST06_02_PL00S06S_42_header_ROM_END = __romPos;
    ST06_02_PL00S06S_42_header_VRAM_END = .;

    ST06_02_PL00S06S_42_ROM_START = __romPos;
    ST06_02_PL00S06S_42_VRAM = ADDR(.ST06_02_PL00S06S_42);
    .ST06_02_PL00S06S_42 0x800DBA00 : AT(ST06_02_PL00S06S_42_ROM_START) SUBALIGN(4)
    {
        ST06_02_PL00S06S_42_DATA_START = .;
        PL00S06S_42_data__s = .;
        build/asm/ST06_02/ovl42__PLBIN_PL00S06S.PBD/data/PL00S06S_42.data.s.o(.data);
        ST06_02_PL00S06S_42_DATA_END = .;
        ST06_02_PL00S06S_42_DATA_SIZE = ABSOLUTE(ST06_02_PL00S06S_42_DATA_END - ST06_02_PL00S06S_42_DATA_START);
    }
    __romPos += SIZEOF(.ST06_02_PL00S06S_42);
    __romPos = ALIGN(__romPos, 16);
    ST06_02_PL00S06S_42_ROM_END = __romPos;
    ST06_02_PL00S06S_42_VRAM_END = .;

    /DISCARD/ :
    {
        *(*);
    }
}
