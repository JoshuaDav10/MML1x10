SECTIONS
{
    __romPos = 0;
    _gp = 0x0;
    ST05_00B_PL00D05M_18_header_ROM_START = __romPos;
    ST05_00B_PL00D05M_18_header_VRAM = ADDR(.ST05_00B_PL00D05M_18_header);
    .ST05_00B_PL00D05M_18_header : AT(ST05_00B_PL00D05M_18_header_ROM_START) SUBALIGN(16)
    {
        ST05_00B_PL00D05M_18_header_DATA_START = .;
        ST05_00B_PL00D05M_18_header_s = .;
        build/asm/ST05_00B/ovl18__PLBIN_PL00D05M.PBD/ST05_00B_PL00D05M_18_header.s.o(.data);
        ST05_00B_PL00D05M_18_header_DATA_END = .;
        ST05_00B_PL00D05M_18_header_DATA_SIZE = ABSOLUTE(ST05_00B_PL00D05M_18_header_DATA_END - ST05_00B_PL00D05M_18_header_DATA_START);
    }
    __romPos += SIZEOF(.ST05_00B_PL00D05M_18_header);
    ST05_00B_PL00D05M_18_header_ROM_END = __romPos;
    ST05_00B_PL00D05M_18_header_VRAM_END = .;

    ST05_00B_PL00D05M_18_ROM_START = __romPos;
    ST05_00B_PL00D05M_18_VRAM = ADDR(.ST05_00B_PL00D05M_18);
    .ST05_00B_PL00D05M_18 0x800E9600 : AT(ST05_00B_PL00D05M_18_ROM_START) SUBALIGN(4)
    {
        ST05_00B_PL00D05M_18_DATA_START = .;
        PL00D05M_18_data__s = .;
        build/asm/ST05_00B/ovl18__PLBIN_PL00D05M.PBD/data/PL00D05M_18.data.s.o(.data);
        ST05_00B_PL00D05M_18_DATA_END = .;
        ST05_00B_PL00D05M_18_DATA_SIZE = ABSOLUTE(ST05_00B_PL00D05M_18_DATA_END - ST05_00B_PL00D05M_18_DATA_START);
    }
    __romPos += SIZEOF(.ST05_00B_PL00D05M_18);
    __romPos = ALIGN(__romPos, 16);
    ST05_00B_PL00D05M_18_ROM_END = __romPos;
    ST05_00B_PL00D05M_18_VRAM_END = .;

    /DISCARD/ :
    {
        *(*);
    }
}
