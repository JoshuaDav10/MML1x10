SECTIONS
{
    __romPos = 0;
    _gp = 0x0;
    ARM11R_PL00R11M_2_header_ROM_START = __romPos;
    ARM11R_PL00R11M_2_header_VRAM = ADDR(.ARM11R_PL00R11M_2_header);
    .ARM11R_PL00R11M_2_header : AT(ARM11R_PL00R11M_2_header_ROM_START) SUBALIGN(16)
    {
        ARM11R_PL00R11M_2_header_DATA_START = .;
        ARM11R_PL00R11M_2_header_s = .;
        build/asm/ARM11R/ovl2__PLBIN_PL00R11M.PBD/ARM11R_PL00R11M_2_header.s.o(.data);
        ARM11R_PL00R11M_2_header_DATA_END = .;
        ARM11R_PL00R11M_2_header_DATA_SIZE = ABSOLUTE(ARM11R_PL00R11M_2_header_DATA_END - ARM11R_PL00R11M_2_header_DATA_START);
    }
    __romPos += SIZEOF(.ARM11R_PL00R11M_2_header);
    ARM11R_PL00R11M_2_header_ROM_END = __romPos;
    ARM11R_PL00R11M_2_header_VRAM_END = .;

    ARM11R_PL00R11M_2_ROM_START = __romPos;
    ARM11R_PL00R11M_2_VRAM = ADDR(.ARM11R_PL00R11M_2);
    .ARM11R_PL00R11M_2 0x800EF600 : AT(ARM11R_PL00R11M_2_ROM_START) SUBALIGN(4)
    {
        ARM11R_PL00R11M_2_DATA_START = .;
        PL00R11M_2_data__s = .;
        build/asm/ARM11R/ovl2__PLBIN_PL00R11M.PBD/data/PL00R11M_2.data.s.o(.data);
        ARM11R_PL00R11M_2_DATA_END = .;
        ARM11R_PL00R11M_2_DATA_SIZE = ABSOLUTE(ARM11R_PL00R11M_2_DATA_END - ARM11R_PL00R11M_2_DATA_START);
    }
    __romPos += SIZEOF(.ARM11R_PL00R11M_2);
    __romPos = ALIGN(__romPos, 16);
    ARM11R_PL00R11M_2_ROM_END = __romPos;
    ARM11R_PL00R11M_2_VRAM_END = .;

    /DISCARD/ :
    {
        *(*);
    }
}
