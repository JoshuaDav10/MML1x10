SECTIONS
{
    __romPos = 0;
    _gp = 0x0;
    ARM09R_PL00R09S_1_header_ROM_START = __romPos;
    ARM09R_PL00R09S_1_header_VRAM = ADDR(.ARM09R_PL00R09S_1_header);
    .ARM09R_PL00R09S_1_header : AT(ARM09R_PL00R09S_1_header_ROM_START) SUBALIGN(16)
    {
        ARM09R_PL00R09S_1_header_DATA_START = .;
        ARM09R_PL00R09S_1_header_s = .;
        build/asm/ARM09R/ovl1__PLBIN_PL00R09S.PBD/ARM09R_PL00R09S_1_header.s.o(.data);
        ARM09R_PL00R09S_1_header_DATA_END = .;
        ARM09R_PL00R09S_1_header_DATA_SIZE = ABSOLUTE(ARM09R_PL00R09S_1_header_DATA_END - ARM09R_PL00R09S_1_header_DATA_START);
    }
    __romPos += SIZEOF(.ARM09R_PL00R09S_1_header);
    ARM09R_PL00R09S_1_header_ROM_END = __romPos;
    ARM09R_PL00R09S_1_header_VRAM_END = .;

    ARM09R_PL00R09S_1_ROM_START = __romPos;
    ARM09R_PL00R09S_1_VRAM = ADDR(.ARM09R_PL00R09S_1);
    .ARM09R_PL00R09S_1 0x800DC880 : AT(ARM09R_PL00R09S_1_ROM_START) SUBALIGN(4)
    {
        ARM09R_PL00R09S_1_DATA_START = .;
        PL00R09S_1_data__s = .;
        build/asm/ARM09R/ovl1__PLBIN_PL00R09S.PBD/data/PL00R09S_1.data.s.o(.data);
        ARM09R_PL00R09S_1_DATA_END = .;
        ARM09R_PL00R09S_1_DATA_SIZE = ABSOLUTE(ARM09R_PL00R09S_1_DATA_END - ARM09R_PL00R09S_1_DATA_START);
    }
    __romPos += SIZEOF(.ARM09R_PL00R09S_1);
    __romPos = ALIGN(__romPos, 16);
    ARM09R_PL00R09S_1_ROM_END = __romPos;
    ARM09R_PL00R09S_1_VRAM_END = .;

    /DISCARD/ :
    {
        *(*);
    }
}
