SECTIONS
{
    __romPos = 0;
    _gp = 0x0;
    INIT_DAT_PL00L04M_10_header_ROM_START = __romPos;
    INIT_DAT_PL00L04M_10_header_VRAM = ADDR(.INIT_DAT_PL00L04M_10_header);
    .INIT_DAT_PL00L04M_10_header : AT(INIT_DAT_PL00L04M_10_header_ROM_START) SUBALIGN(16)
    {
        INIT_DAT_PL00L04M_10_header_DATA_START = .;
        INIT_DAT_PL00L04M_10_header_s = .;
        build/asm/INIT_DAT/ovl10__PLBIN_PL00L04M.PBD/INIT_DAT_PL00L04M_10_header.s.o(.data);
        INIT_DAT_PL00L04M_10_header_DATA_END = .;
        INIT_DAT_PL00L04M_10_header_DATA_SIZE = ABSOLUTE(INIT_DAT_PL00L04M_10_header_DATA_END - INIT_DAT_PL00L04M_10_header_DATA_START);
    }
    __romPos += SIZEOF(.INIT_DAT_PL00L04M_10_header);
    INIT_DAT_PL00L04M_10_header_ROM_END = __romPos;
    INIT_DAT_PL00L04M_10_header_VRAM_END = .;

    INIT_DAT_PL00L04M_10_ROM_START = __romPos;
    INIT_DAT_PL00L04M_10_VRAM = ADDR(.INIT_DAT_PL00L04M_10);
    .INIT_DAT_PL00L04M_10 0x800F3600 : AT(INIT_DAT_PL00L04M_10_ROM_START) SUBALIGN(4)
    {
        INIT_DAT_PL00L04M_10_DATA_START = .;
        PL00L04M_10_data__s = .;
        build/asm/INIT_DAT/ovl10__PLBIN_PL00L04M.PBD/data/PL00L04M_10.data.s.o(.data);
        INIT_DAT_PL00L04M_10_DATA_END = .;
        INIT_DAT_PL00L04M_10_DATA_SIZE = ABSOLUTE(INIT_DAT_PL00L04M_10_DATA_END - INIT_DAT_PL00L04M_10_DATA_START);
    }
    __romPos += SIZEOF(.INIT_DAT_PL00L04M_10);
    __romPos = ALIGN(__romPos, 16);
    INIT_DAT_PL00L04M_10_ROM_END = __romPos;
    INIT_DAT_PL00L04M_10_VRAM_END = .;

    /DISCARD/ :
    {
        *(*);
    }
}
