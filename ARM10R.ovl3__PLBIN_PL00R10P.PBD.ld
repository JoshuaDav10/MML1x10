SECTIONS
{
    __romPos = 0;
    _gp = 0x0;
    ARM10R_PL00R10P_3_header_ROM_START = __romPos;
    ARM10R_PL00R10P_3_header_VRAM = ADDR(.ARM10R_PL00R10P_3_header);
    .ARM10R_PL00R10P_3_header : AT(ARM10R_PL00R10P_3_header_ROM_START) SUBALIGN(16)
    {
        ARM10R_PL00R10P_3_header_DATA_START = .;
        ARM10R_PL00R10P_3_header_s = .;
        build/asm/ARM10R/ovl3__PLBIN_PL00R10P.PBD/ARM10R_PL00R10P_3_header.s.o(.data);
        ARM10R_PL00R10P_3_header_DATA_END = .;
        ARM10R_PL00R10P_3_header_DATA_SIZE = ABSOLUTE(ARM10R_PL00R10P_3_header_DATA_END - ARM10R_PL00R10P_3_header_DATA_START);
    }
    __romPos += SIZEOF(.ARM10R_PL00R10P_3_header);
    ARM10R_PL00R10P_3_header_ROM_END = __romPos;
    ARM10R_PL00R10P_3_header_VRAM_END = .;

    ARM10R_PL00R10P_3_ROM_START = __romPos;
    ARM10R_PL00R10P_3_VRAM = ADDR(.ARM10R_PL00R10P_3);
    .ARM10R_PL00R10P_3 0x800FB500 : AT(ARM10R_PL00R10P_3_ROM_START) SUBALIGN(4)
    {
        ARM10R_PL00R10P_3_DATA_START = .;
        PL00R10P_3_data__s = .;
        build/asm/ARM10R/ovl3__PLBIN_PL00R10P.PBD/data/PL00R10P_3.data.s.o(.data);
        ARM10R_PL00R10P_3_DATA_END = .;
        ARM10R_PL00R10P_3_DATA_SIZE = ABSOLUTE(ARM10R_PL00R10P_3_DATA_END - ARM10R_PL00R10P_3_DATA_START);
    }
    __romPos += SIZEOF(.ARM10R_PL00R10P_3);
    __romPos = ALIGN(__romPos, 16);
    ARM10R_PL00R10P_3_ROM_END = __romPos;
    ARM10R_PL00R10P_3_VRAM_END = .;

    /DISCARD/ :
    {
        *(*);
    }
}
