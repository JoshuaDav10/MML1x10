SECTIONS
{
    __romPos = 0;
    _gp = 0x0;
    ARM05R_PL00R05P_3_header_ROM_START = __romPos;
    ARM05R_PL00R05P_3_header_VRAM = ADDR(.ARM05R_PL00R05P_3_header);
    .ARM05R_PL00R05P_3_header : AT(ARM05R_PL00R05P_3_header_ROM_START) SUBALIGN(16)
    {
        ARM05R_PL00R05P_3_header_DATA_START = .;
        ARM05R_PL00R05P_3_header_s = .;
        build/asm/ARM05R/ovl3__PLBIN_PL00R05P.PBD/ARM05R_PL00R05P_3_header.s.o(.data);
        ARM05R_PL00R05P_3_header_DATA_END = .;
        ARM05R_PL00R05P_3_header_DATA_SIZE = ABSOLUTE(ARM05R_PL00R05P_3_header_DATA_END - ARM05R_PL00R05P_3_header_DATA_START);
    }
    __romPos += SIZEOF(.ARM05R_PL00R05P_3_header);
    ARM05R_PL00R05P_3_header_ROM_END = __romPos;
    ARM05R_PL00R05P_3_header_VRAM_END = .;

    ARM05R_PL00R05P_3_ROM_START = __romPos;
    ARM05R_PL00R05P_3_VRAM = ADDR(.ARM05R_PL00R05P_3);
    .ARM05R_PL00R05P_3 0x800FB500 : AT(ARM05R_PL00R05P_3_ROM_START) SUBALIGN(4)
    {
        ARM05R_PL00R05P_3_DATA_START = .;
        PL00R05P_3_data__s = .;
        build/asm/ARM05R/ovl3__PLBIN_PL00R05P.PBD/data/PL00R05P_3.data.s.o(.data);
        ARM05R_PL00R05P_3_DATA_END = .;
        ARM05R_PL00R05P_3_DATA_SIZE = ABSOLUTE(ARM05R_PL00R05P_3_DATA_END - ARM05R_PL00R05P_3_DATA_START);
    }
    __romPos += SIZEOF(.ARM05R_PL00R05P_3);
    __romPos = ALIGN(__romPos, 16);
    ARM05R_PL00R05P_3_ROM_END = __romPos;
    ARM05R_PL00R05P_3_VRAM_END = .;

    /DISCARD/ :
    {
        *(*);
    }
}
